// game_config.vh is generated by `python3 tools/merge_roms.py <game>`;
// for MCR-3 it defines GAME_TAPPER (etc.) to select the input/DIP mapping.
`include "game_config.vh"

// Tang Console 60K top for the MCR-3 (91490) Arcade Core. This is the MCR-2
// top with the core swapped for src/rtl/mcr3.vhd; the shared platform (PLL,
// DDR3 framebuffer/HDMI, analog video, USB, OSD, beacon, audio) is
// identical. MCR-3 INCREMENT 0 (this build): CPU/sound/bg baked in BSRAM
// like MCR-1/2, and the 128 KB sprite ROM is NOT yet wired - sp_graphx32_do
// is tied to 0, so sprites render blank. This proves the core + CPU +
// background + video pipeline on our platform. INCREMENT 1 adds the SDRAM
// sprite path (sdram_gw sp port at 80 MHz) + the SD->SDRAM sprite loader.
module mcr123s_console60k_top (
    input        sys_clk,       // 50 MHz on-board oscillator (pin V22)
    input        s1,            // User key AA13 - ACTIVE LOW on console (pull-up)
    input        reset2,        // User key AB13 - ACTIVE LOW on console (pull-up)

    // DVI/HDMI output.
    // hpd_en drives the dock's HDMI enable. Sipeed's own NEO_DOCK example
    // drives this pin at DRIVE=12; nand2mario's cores leave it unassigned
    // (tri-stated with a weak internal pull-up), which is what we did too.
    // If the net has an external pull-down, that weak pull-up loses and the
    // dock's HDMI stays disabled - and because JTAG reconfiguration does not
    // power-cycle the board, whether a previous core left the line high can
    // decide if a picture appears. Drive it explicitly.
    output       hpd_en,
    output       tmds_clk_p,
    output       tmds_clk_n,
    output [2:0] tmds_d_p,
    output [2:0] tmds_d_n,

    // On-SOM DDR3 (framebuffer backing store; pins from gbatang console60k)
    output [14:0] ddr_addr,
    output [2:0]  ddr_bank,
    output        ddr_cs,
    output        ddr_ras,
    output        ddr_cas,
    output        ddr_we,
    output        ddr_ck,
    output        ddr_ck_n,
    output        ddr_cke,
    output        ddr_odt,
    output        ddr_reset_n,
    output [1:0]  ddr_dm,
    inout  [15:0] ddr_dq,
    inout  [1:0]  ddr_dqs,
    inout  [1:0]  ddr_dqs_n,

    // PMOD sockets, repurposed to host the Digilent PmodVGA directly.
    // (Desk buttons retired - inputs come from the USB pad and board keys.)
    // Sipeed socket IO order differs from Digilent pin order; the physical
    // row/socket orientation is resolved at runtime by the two map_* straps.
    output [7:0] pmod0_io,
    output [7:0] pmod1_io,
    input        map_rows_n,     // J10-39 strap: open/GND = try both
    input        map_sock_n,     // J10-40 strap: open/GND = try both

    // Digilent PmodVGA (4:4:4 + HS/VS) wired to J10 header - see CST for the
    // jumper recipe. Analog output has no line buffer -> no shimmer/tearing.
    output [3:0] vga_r,
    output [3:0] vga_g,
    output [3:0] vga_b,
    output       vga_hs,
    output       vga_vs,

    // 15/31 kHz select strap on J10 (internal pull-up):
    // open = 31 kHz progressive (VGA monitor), jumper to GND = 15 kHz
    // native arcade timing (CRT / OSSC / RetroTink; VGA LCDs will not sync)
    input        mode15_n,

    // USB-A port 1 (left) - USB HID host (15k pulldowns are on the board)
    inout        usb1_dp,
    inout        usb1_dn,

    // MicroSD card (SPI mode) - optional ROM source, see rom_loader.sv
    output       sd_clk,
    output       sd_cmd,      // MOSI
    input        sd_dat0,     // MISO
    output       sd_dat3,     // CS

    // DDR3/HDMI bring-up debug (J10 pins 21-24; see comment at the logic)
    output [3:0] debug_o,

    // Status beacon on the FPGA->BL616 UART (shows up as USB-C serial,
    // 115200 8N1): one "FB c_ r_ x____ q__" line every ~0.5s
    output       uart_tx,

    // PWM Audio output
    output       audio_l,
    output       audio_r,

    // Tang SDRAM module (J9) - holds the 128 KB sprite ROM (too big for BSRAM).
    // Pins from the verified sdram_memtest.cst (nand2mario snestang layout);
    // CKE is tied high on the module (no FPGA pin). Bank is 3.3V (these balls
    // are NOT in the DDR3's bank 9), so LVCMOS33 coexists with the framebuffer.
    inout  [15:0] O_sdram_dq_io,
    output [12:0] O_sdram_addr,
    output [1:0]  O_sdram_ba,
    output [1:0]  O_sdram_dqm,
    output        O_sdram_clk,
    output        O_sdram_cs_n,
    output        O_sdram_wen_n,
    output        O_sdram_ras_n,
    output        O_sdram_cas_n
);

assign hpd_en = 1'b1;   // enable the dock's HDMI path

// --- Clock Generation ---
// gowin_pll_core80 (60K/MCR-3 variant, VCO=800): drops the unused 125 MHz TMDS
// clock and adds clk_sdram = 80 MHz = 2x clk_sys, phase-locked off the same VCO
// so the SDRAM sprite read is a synchronous 1:2 crossing to the 40 MHz core.
wire clk_sys;    // 40 MHz  (Core system clock, generates 20 MHz pixel enable)
wire clk_sdram;  // 80 MHz  (SDRAM controller, synchronous 2x clk_sys)
// 225-deg copy for the SDRAM_CLK pin (sdram_gw clk_fwd). NOTE: this wire was
// referenced-but-undeclared for several builds - Gowin silently made it a
// floating net (the CLAUDE.md gotcha, on a CLOCK) - which invalidated the
// earlier "90 deg made no difference" experiment. Declared-before-use now.
wire clk_sdram_ph;
wire pll_locked;

wire clk50_pll;  // PLL-buffered 50 MHz for the DDR3 controller/mDRP (clk_g).
                 // Feeding the raw pad clock there put a derived clock on
                 // generic routing (PR1014) and the DDR3 IP never came up.
gowin_pll_core80 pll_inst (
    .clkin(sys_clk),
    .clk_sys(clk_sys),
    .clk_sdram(clk_sdram),
    .clk_sdram_ph(clk_sdram_ph),   // 225 deg - the proven SDRAM pin clock
    .clk_50(clk50_pll),
    .lock(pll_locked)
);

// 27 MHz reference for the DDR3 framebuffer's internal PLLs (720p + DDR3)
wire clk27;
pll_27 pll27_inst (
    .clkin(sys_clk),
    .clkout0(clk27)
);

// Second PLLA: 50 MHz -> exactly 12 MHz for the USB HID host
// (VCO = 50*18 = 900 MHz, ODIV0 = 75; config from nand2mario's usb_hid_host)
wire clk_usb;
gowin_pll_usb pll_usb_inst (
    .clkin(sys_clk),
    .clkout(clk_usb)
);

// --- Reset Generation ---
// Unlike the Primer 25K (buttons active high w/ pulldown), the Tang Console's
// user keys are active LOW with pull-ups. Invert once here; the rest of the
// design keys off the active-high key_s1/key_s2 exactly like the 25K top.
wire key_s1 = ~s1;
wire key_s2 = ~reset2;

// 15 kHz strap, synchronized into the core clock domain (active low pin).
// Live toggling works; if the picture is disturbed after moving the jumper,
// press S1 (reset) once.
reg mode15_s1 = 0, mode15_s2 = 0;
always @(posedge clk_sys) begin
    mode15_s1 <= ~mode15_n;
    mode15_s2 <= mode15_s1;
end
wire tv15khz = mode15_s2;

// (Video note: the DDR3 framebuffer captures whatever timing the core emits,
// so HDMI stays alive in 15 kHz mode too - capture height drops to 240
// lines per field and the upscaler adapts.)

reg [7:0] reset_cnt = 255;
// BOOT KICK state (logic lives in the reset_cnt block just below).
reg       boot_kicked = 1'b0;
reg       rom_ready_d = 1'b0;
wire      rom_ready;                          // ROM image settled
wire core_reset_raw = (reset_cnt != 0);       // resets the SD loader itself

// core_reset is REGISTERED: it fans out to every synchronous reset in the
// core, and as a combinational function of reset_cnt it became the critical
// path (deterministic -0.35ns on the shollow build). One extra cycle of
// reset latency costs nothing.
reg core_reset = 1'b1;
wire       osd_nocard;   // INSERT CARD screen owns the display
// INSERT CARD screen (no baked ROMs any more, so a missing card has nothing
// to fall back on). Two things have to be true while it is up:
//  1. The core must NOT be held in reset. mcr3/mcr2/mcr1.vhd hold hcnt/vcnt
//     at zero under reset, so resetting stops the raster - and the OSD draws
//     in the core raster domain, so the message would vanish into a black
//     screen. The core free-runs on blank RAM instead; osd_nocard blanks its
//     video so none of that garbage is visible behind the text.
//  2. When a card finally loads, the core has been running for a while on
//     nonsense and must be restarted, or the Z80 carries on from wherever it
//     wandered to. Pulse reset on the way out of the screen.
reg       nocard_d      = 1'b0;
reg [7:0] nocard_exit_r = 8'd0;   // ~6us reset pulse on card-found
always @(posedge clk_sys) begin
    nocard_d <= osd_nocard;
    if (nocard_d && !osd_nocard)      nocard_exit_r <= 8'hFF;
    else if (nocard_exit_r != 8'd0)   nocard_exit_r <= nocard_exit_r - 8'd1;
end
always @(posedge clk_sys)
    core_reset <= core_reset_raw
               || (!rom_ready && !osd_nocard)
               || (nocard_exit_r != 8'd0);

// Game selection. game_id picks the input/DIP mapping at RUNTIME (all six
// maps are compiled in); game_slot tells the SD loader which pack slot to
// (re)load. Both are owned by the OSD menu (Select+Start on the pad).
// The power-on default is whatever game merge_roms.py baked into BSRAM, so
// map and ROMs always match at boot - with or without a card.
// Slot order = tools/merge_roms.py GAME_SPECS order (= the pack's order).
// MCR-3 roster (Increment 0: Tapper only). Timber/Journey/DoT slot in later.
localparam [2:0] GAME_DEFAULT = 3'd0;   // Tapper

// 4 bits since the OSD roster widened to 16 slots. Each family still has
// <= 8 games, so the input mux and beacon below take game_id[2:0] - exact
// today, and an explicit narrowing rather than a silent truncation.
wire [3:0] game_id;      // game the core is running (from the OSD)
// ---------------------------------------------------------------------------
// MERGED ROSTER (MCR-3 + MCR-2 in one bitstream)
// The OSD works in a FLAT roster index; the SD pack is addressed by
// (family, slot). Translate in both directions here - nothing else in the
// design needs to know the roster is split across two families.
//   idx 0..2 -> family 2 (MCR-3): tapper, timber, dotron
//   idx 3..8 -> family 1 (MCR-2): shollow, tron, wacko, kroozr, twotiger, domino
// ---------------------------------------------------------------------------
// Cheap Squeak Deluxe (68000 + PIA) build switch. 1 = all three MCR3Scroll
// titles; 0 = Crater Raider only (SSIO sound), which drops the whole FX68K
// stack. Set to 0 to measure what the 68000 costs in isolation - the number
// this project has twice got wrong by arithmetic instead of PnR.
localparam int SCROLL_CSD = 1;

// Sound ROM location. 1 = SDRAM (frees the 8 BSRAM blocks the 16 KB RAM costs
// and is what makes the 3-family merge fit); 0 = BSRAM, as the shipping mcr23
// core has it.
//
// The sound Z80 runs at 2 MHz - mcr_sound_board divides clk_sys by 20 - so its
// address is stable for ~500 ns per fetch against sdram_gw's ~7 clk_sys worst
// case. That is roughly 3x the margin the MAIN Z80 has, which is why TODO 4c's
// CPU-ROM-in-SDRAM attempt failed while this one is expected to work. It has
// NOT been verified on hardware; 4c left it "not disproven, not verified".
// Note: with this set, the stored-ROM audit's `snd` leg reads all-zero (the
// region has no port B to sweep) - E4 is meaningless, E5/E6/E7 still valid.
localparam int SND_IN_SDRAM = 1;

localparam [7:0] FAM_MCR1 = 8'd0, FAM_MCR2 = 8'd1, FAM_MCR3 = 8'd2, FAM_SCROLL = 8'd3;
localparam [4:0] OSD_DEFAULT_IDX = 5'd0;   // Tapper
localparam [4:0] N_MCR3   = 5'd3;          // MCR-3 entries come first
localparam [4:0] N_MCR2   = 5'd6;          // then MCR-2
localparam [4:0] N_M32    = N_MCR3 + N_MCR2;   // 9  = first MCR3Scroll index
localparam [4:0] N_SCROLL = 5'd3;
localparam [4:0] N_M32S   = N_M32 + N_SCROLL;  // 12 = first MCR-1 index

function [7:0] idx_family(input [4:0] idx);
    idx_family = (idx < N_MCR3) ? FAM_MCR3 :
                 (idx < N_M32)  ? FAM_MCR2 :
                 (idx < N_M32S) ? FAM_SCROLL : FAM_MCR1;
endfunction
function [3:0] idx_slot(input [4:0] idx);
    idx_slot = (idx < N_MCR3) ? idx[3:0] :
               (idx < N_M32)  ? (idx[3:0] - N_MCR3[3:0]) :
               (idx < N_M32S) ? (idx[3:0] - N_M32[3:0])
                              : (idx[3:0] - N_M32S[3:0]);
endfunction
function [4:0] fam_slot_to_idx(input [7:0] fam, input [3:0] slot);
    fam_slot_to_idx = (fam == FAM_MCR3)   ? {1'b0, slot}
                    : (fam == FAM_MCR2)   ? ({1'b0, slot} + N_MCR3)
                    : (fam == FAM_SCROLL) ? ({1'b0, slot} + N_M32)
                                          : ({1'b0, slot} + N_M32S);
endfunction

wire       osd_restart;  // OSD pulse: restart the loader
wire       osd_active;   // menu open -> game inputs masked below

// DIAGNOSTIC: count reset events and rom_ready rises so the beacon can say
// whether the boot kick actually fired, instead of us inferring it. Three
// attempts at this fix have now failed and each cost a power-cycle; measure
// first. Reported in slot E2 as {rr_rises[7:0], rst_evts[6:0], boot_kicked}.
reg [7:0] rst_evts = 8'd0;    // times reset_cnt was (re)loaded
reg [7:0] rr_rises = 8'd0;    // rising edges of rom_ready seen
reg [31:0] up_cnt   = 32'd0;  // free-running time since config (40MHz)
reg        kick2_done = 1'b1; // 35s kick RETIRED (wedge watchdog supersedes)
reg [7:0]  kick_n     = 8'd0; // wedge-watchdog kicks issued this power-on
wire       wedge_kick;        // assigned below the liveliness meter

always @(posedge clk_sys) begin
    if (!(&up_cnt)) up_cnt <= up_cnt + 32'd1;   // saturate, no wrap re-kick
    rom_ready_d <= rom_ready;
    if (rom_ready && !rom_ready_d) rr_rises <= rr_rises + 8'd1;

    if (key_s1 || !pll_locked) begin
        reset_cnt   <= 255;
        boot_kicked <= 1'b0;             // re-arm for the next boot
        if (!core_reset_raw) rst_evts <= rst_evts + 8'd1;
    end else if (rom_ready && !rom_ready_d && !boot_kicked) begin
        reset_cnt   <= 255;              // BOOT KICK - see comment below
        boot_kicked <= 1'b1;
        rst_evts    <= rst_evts + 8'd1;
    end else if (wedge_kick) begin
        // WEDGE WATCHDOG (replaces the fixed 35s kick2): if the CPU bus has
        // gone quiet after the core was released - the halted-in-data-table
        // crash signature - issue another full reset attempt, forever, every
        // ~6.7s. Each cold boot self-heals at the earliest kick that works,
        // and kick_n in the beacon records how many were needed, i.e. it
        // MEASURES the settle time per boot instead of assuming 35s.
        reset_cnt   <= 255;
        kick_n      <= kick_n + 8'd1;
        rst_evts    <= rst_evts + 8'd1;
    end else if (up_cnt == 32'd1_400_000_000 && !kick2_done) begin
        // EXPERIMENT kick2: a second full reset ~35s after config. The
        // manual reset button (same reset path, pressed a minute in) cures
        // the black cold boot where the early kick does not - the only
        // difference is TIME. If this cures it, the blocker is something
        // that needs tens of seconds to settle; find it next. If it does
        // not, the button does something this path cannot, which is a
        // contradiction worth having.
        reset_cnt   <= 255;
        kick2_done  <= 1'b1;
        rst_evts    <= rst_evts + 8'd1;
    end else if (reset_cnt != 0) begin
        reset_cnt <= reset_cnt - 8'd1;
    end
end

// BOOT KICK (implemented in the reset_cnt block above): once the ROMs are
// actually in place, give the whole front end - core, SD loader AND the
// SDRAM controller - one more reset, exactly as pressing the reset key does.
//
// Measured on hardware: merely deasserting a long-held core reset when
// ldr_done rises is NOT enough (the core then free-runs its raster at
// ~69.5 Hz with a black picture and the game never starts), and neither is
// a core-only reset pulse - that was tried and Tapper still needed the
// button. Reloading reset_cnt is what works, because core_reset_raw also
// resets the loader, producing a second clean load (spw_count 0x200->0x400)
// with everything already settled.
//
// The boot_kicked one-shot is what stops this from boot-looping: the second
// load re-raises rom_ready, but the latch is set by then so no further kick
// is issued. A manual reset clears it and the cycle runs once more.
//
// This is structural, not a workaround. Phase 2 moves CPU/sound/bg ROMs out
// of BSRAM and into SDRAM as well, at which point "hold the core in reset
// until every region has been written, then reset once more" is simply the
// correct boot contract - a core that starts mid-load executes garbage.
// Keep this when the ROM source changes; widen rom_ready to cover all
// regions rather than deleting the kick.

// --- ROM source ---------------------------------------------------------
// The INIT_FILE contents are the power-on default (whatever game
// `merge_roms.py` last generated - Tron by default), so the board always
// boots something even with no SD card. When a card holding a valid pack is
// present, rom_loader overwrites these memories before the core leaves
// reset and the DIP-selected game runs instead.
wire        sd_ready, sd_err, sd_rd_start, sd_rd_done, sd_dv;
wire [7:0]  sd_dout;
wire [31:0] sd_sector;
wire        sd_wr_start, sd_wr_next, sd_wr_done;
wire [7:0]  sd_wr_din;
// 19-bit: MCR3Scroll's payload is 288 KB - its char/alpha plane and the Cheap
// Squeak Deluxe 68000 ROM sit above the 128 KB sprite blob, past the 256 KB
// that 18 bits covers. rom_loader takes the width as a parameter so the
// single-family boards keep their exact 18-bit bus.
localparam int DL_AW = 19;
wire [DL_AW-1:0] dl_addr;
wire [7:0]  dl_data;
wire        dl_wr;
wire        dl_v2;     // loader detected a v2 pack (region map below)
wire        ldr_done, ldr_error, ldr_saved;
// Which (family, slot) the loader should fetch, and which family is RUNNING.
//  - OSD open: the user picked a roster index; translate it.
//  - boot: the loader reads the prefs sector FIRST, so its pref_core/pref_slot
//    are settled before the pack-entry search needs `family`. Fall back to the
//    default if the saved family is not one this bitstream contains (e.g. a
//    card last used on an MCR-1 build).
wire [7:0] ldr_pref_core;
wire       ldr_pref_valid;
wire [4:0] osd_idx;                       // roster index the OSD wants
wire [7:0] osd_family = idx_family(osd_idx);
wire [3:0] osd_slot   = idx_slot(osd_idx);
wire       pref_fam_ok = ldr_pref_valid &&
                         (ldr_pref_core == FAM_MCR1 || ldr_pref_core == FAM_MCR2 ||
                          ldr_pref_core == FAM_MCR3 || ldr_pref_core == FAM_SCROLL);
wire [7:0] boot_family = pref_fam_ok ? ldr_pref_core : FAM_MCR3;
// The loader uses this both to FIND the pack entry during a load and to write
// prefs byte 9 on a save. Those happen at different times, so it has to hold:
//   during an OSD load  -> osd_family (the menu is still open)
//   during the boot load -> boot_family (from prefs; osd closed, no load done)
//   after any load      -> run_family, the family actually loaded
// Without the last case the SAVE ran after the menu closed and recorded
// boot_family instead of the game just chosen - picking an MCR-2 game wrote
// family 2, so the next boot came up on an MCR-3 game.
// The family THIS load is using. Kept free of any dependency on run_family,
// which is latched FROM it - the previous version read
// `ldr_done ? run_family : boot_family`, and since run_family latches on the
// same edge that ldr_done rises, it latched its own stale value. The data
// loaded fine (the entry search runs while ldr_done is still low) but the
// index and the ACTIVE CORE came out wrong.
wire [7:0] load_family = osd_active ? osd_family : boot_family;
// What the loader sees: the load family during a load, then the family that
// was actually loaded, so a save records the right one after the menu closes.
wire [7:0] ldr_family  = ldr_done ? run_family : load_family;
wire       ldr_is_mcr2 = (load_family == FAM_MCR2);  // declared before use
wire       ldr_is_scroll = (load_family == FAM_SCROLL);
wire       ldr_is_mcr1   = (load_family == FAM_MCR1);
// Boot fallback slot, used only when the prefs sector has no valid entry.
// (game_slot is gone: the OSD now emits a roster INDEX, not a pack slot.)
wire [3:0] ldr_slot_req = osd_active ? osd_slot : idx_slot(OSD_DEFAULT_IDX);
// The family actually running: latched when a load completes, so a failed
// load leaves the previous core selected and playable.
reg  [7:0] run_family = FAM_MCR3;
reg        ldr_done_d = 1'b0;
always @(posedge clk_sys) begin
    ldr_done_d <= ldr_done;
    if (ldr_done && !ldr_done_d) run_family <= load_family;
end
wire run_is_mcr3   = (run_family == FAM_MCR3);
wire run_is_scroll = (run_family == FAM_SCROLL);
wire run_is_mcr2   = (run_family == FAM_MCR2);
wire run_is_mcr1   = (run_family == FAM_MCR1);
wire [3:0]  ldr_slot;      // slot actually loaded (SD-saved pref at boot)
wire        osd_save;      // OSD: persist the selection to the prefs sector

// Core runs once the loader has finished, or as soon as it gives up on a
// missing/unreadable card (then the baked-in ROMs stand).
assign rom_ready = ldr_done | ldr_error;

// ldr_sd_rst lets the loader force a full card re-init between retries;
// sd_reader latches `err`, so without it a transient failure (e.g. the card
// left mid-command by JTAG reconfiguration) could never be cleared.
wire ldr_sd_rst;

sd_reader #(.CLK_HZ(40_000_000)) sd (
    .clk(clk_sys), .rst(core_reset_raw | ldr_sd_rst),
    .ready(sd_ready), .err(sd_err),
    .rd_start(sd_rd_start), .rd_sector(sd_sector),
    .dout(sd_dout), .dout_valid(sd_dv), .rd_done(sd_rd_done),
    .wr_start(sd_wr_start), .wr_din(sd_wr_din),
    .wr_next(sd_wr_next), .wr_done(sd_wr_done), .wr_err(),
    .sclk(sd_clk), .mosi(sd_cmd), .miso(sd_dat0), .cs_n(sd_dat3)
);

// MAX_RETRY raised: MCR-3 sprites live on the card, so a boot that gives up
// early renders white/garbage sprites rather than degrading gracefully.
rom_loader #(.PACK_BASE(32'd2048), .SLOT_SECTORS(256), .MAX_RETRY(3'd7),
             .FAMILY(8'd2), .DL_AW(DL_AW)) loader ( // 2 = mcr3 entries in a v2 pack
    .clk(clk_sys), .rst(core_reset_raw | osd_restart),
    .slot(ldr_slot_req), .family(ldr_family),
    // Boot consults the SD-saved preference; an OSD-commanded reload
    // (menu open) loads exactly the slot the user picked.
    // INSERT CARD retries still honour the saved game (osd_active alone
    // would force prefs off and lose the owner's selection)
    .use_prefs(~osd_active | osd_nocard),
    .save_req(osd_save), .saved(ldr_saved),
    .cur_slot(ldr_slot),
    .sd_ready(sd_ready), .sd_err(sd_err), .sd_rst(ldr_sd_rst),
    .sd_rd_start(sd_rd_start), .sd_sector(sd_sector),
    .sd_dout(sd_dout), .sd_dout_valid(sd_dv), .sd_rd_done(sd_rd_done),
    .sd_wr_start(sd_wr_start), .sd_wr_din(sd_wr_din),
    .sd_wr_next(sd_wr_next), .sd_wr_done(sd_wr_done),
    .dl_addr(dl_addr), .dl_data(dl_data), .dl_wr(dl_wr), .v2_mode(dl_v2),
    .pref_core(ldr_pref_core), .pref_core_valid(ldr_pref_valid),
    .done(ldr_done), .error(ldr_error)
);

// Phase 1 (sprites-first): CPU/sound/bg stay BAKED in BSRAM (INIT_FILE); the
// SD pack holds ONLY the 128 KB sprite blob, and the whole dl stream is routed
// to SDRAM below. So the CPU/sound dl-write ports are held off here (a sprite
// byte at dl_addr < 0x10000 must NOT land in the CPU ROM), and the core's
// dl_wr is tied low (its bg dl-decode must not overwrite the baked bg).
// v2 pack region map (v1 pack = sprites-only blob, all bytes to SDRAM):
//   0x00000-0x0FFFF CPU 64K -> rom_cpu_inst
//   0x10000-0x13FFF snd 16K -> rom_snd_inst
//   0x14000-0x17FFF bg plane1 16K -> core dl (dl_addr[15:14]==00)
//   0x18000-0x1BFFF bg plane2 16K -> core dl (dl_addr[15:14]==01)
//   0x1C000-0x3BFFF sprites 128K  -> SDRAM port2 (offset -0x1C000)
// Region decode depends on WHICH FAMILY is being loaded - the payload layouts
// differ after the sound ROM:
//   MCR-3: bg1 0x14000-0x17FFF (16K), bg2 0x18000-0x1BFFF (16K), sprites 0x1C000+
//   MCR-2: gfx2 0x14000-0x1BFFF (32K, into the core's own sprite RAM),
//          bg1 0x1C000-0x1DFFF (8K), bg2 0x1E000-0x1FFFF (8K)
//   MCR3Scroll (family 3): same first four regions as MCR-3, then
//          sprites 0x1C000-0x3BFFF (128K), char/alpha 0x3C000-0x3CFFF (4K),
//          CSD 68000 ROM 0x40000-0x47FFF (32K, 16-bit -> SDRAM banks 0/1).
//          The CSD ROM is the one region that CANNOT be BSRAM: 32 KB is 16
//          blocks and the merged build has 4 spare. Upstream MiSTer runs it
//          from SDRAM too (its cpu2 port), and the 68000's DTACK handshake
//          absorbs the latency - unlike the main Z80, which is why TODO 4c's
//          CPU-ROM-in-SDRAM attempt failed.
//   MCR-1 (family 0):  CPU 32K 0x00000 | snd 16K 0x08000 | sprites 32K 0x10000
//          | bg1 4K 0x18000 | bg2 4K 0x19000.  Its CPU is 32 KB and its bg
//          planes 4 KB, so both land at the bottom of the shared 64 KB / 16 KB
//          RAMs and the rest is simply never written.
wire dl_hi      = dl_addr[18];       // only the CSD region lives above 256 KB
wire dl_cpu_rng = dl_v2 && !dl_hi && (ldr_is_mcr1 ? (dl_addr[17:15] == 3'b000)
                                                  : (dl_addr[17:16] == 2'b00));
wire dl_snd_rng = dl_v2 && !dl_hi && (ldr_is_mcr1 ? (dl_addr[17:14] == 4'b0010)
                                                  : (dl_addr[17:14] == 4'b0100));
wire dl_bg1_rng = dl_v2 && !dl_hi &&
                  (ldr_is_mcr1 ? (dl_addr[17:12] == 6'b011000) :
                   ldr_is_mcr2 ? (dl_addr[17:13] == 5'b01110)
                               : (dl_addr[17:14] == 4'b0101));
wire dl_bg2_rng = dl_v2 && !dl_hi &&
                  (ldr_is_mcr1 ? (dl_addr[17:12] == 6'b011001) :
                   ldr_is_mcr2 ? (dl_addr[17:13] == 5'b01111)
                               : (dl_addr[17:14] == 4'b0110));
// sprite blob: MCR-3 runs to the end of its payload, MCR3Scroll stops at
// 0x3C000 where its char plane begins.
wire dl_sp_rng  = (dl_v2 ? (!dl_hi && dl_addr[17:0] >= 18'h1C000 &&
                            (!ldr_is_scroll || dl_addr[17:0] < 18'h3C000))
                         : 1'b1) && !ldr_is_mcr2 && !ldr_is_mcr1;
wire [16:0] dl_sp_off = dl_v2 ? (dl_addr[16:0] - 17'h1C000) : dl_addr[16:0];
// MCR3Scroll-only regions
wire dl_ch_rng  = dl_v2 && ldr_is_scroll && !dl_hi && (dl_addr[17:12] == 6'b111100);
wire dl_csd_rng = dl_v2 && ldr_is_scroll && dl_hi;
wire [14:0] dl_csd_off = dl_addr[14:0];   // 0..0x7FFF within the 32K region
// SHARED 32 KB SPRITE ROM (MCR-1 + MCR-2). Hoisted out of both cores, which
// instantiate structurally identical dprams - see SP_EXTERNAL in mcr1.vhd /
// mcr2.vhd. This is what lets MCR-1 join at all: in BSRAM the two would cost
// 32 blocks between them, and the alternative (sprites -> SDRAM) is the
// pipeline surgery both families' 1-phase sprite path cannot absorb.
//   MCR-1 region 0x10000-0x17FFF, written with a PLAIN address
//   MCR-2 region 0x14000-0x1BFFF, written with bit 14 INVERTED - that twist
//     lives in mcr2.vhd's internal instance, so the top must reproduce it here
wire dl_sp1_rng = dl_v2 && !dl_hi && ldr_is_mcr1 && (dl_addr[17:15] == 3'b010);
wire dl_sp2_rng = dl_v2 && !dl_hi && ldr_is_mcr2 &&
                  (dl_addr[17:0] >= 18'h14000) && (dl_addr[17:0] < 18'h1C000);
wire [14:0] sp_wr_addr = ldr_is_mcr2 ? {~dl_addr[14], dl_addr[13:0]}
                                     : dl_addr[14:0];
wire cpu_rom_we = dl_wr && dl_cpu_rng;
wire snd_rom_we = dl_wr && dl_snd_rng;
// core-facing dl bus: bg planes at the core's own decode addresses
wire        core_dl_wr   = dl_wr && (dl_bg1_rng || dl_bg2_rng);
// MCR3Scroll's own dl bus: only the char/alpha plane is still inside that
// core (its bg pair is hoisted like MCR-3's), and it decodes at 0x8000.
wire [15:0] scroll_dl_addr = {4'b1000, dl_addr[11:0]};
wire        scroll_dl_wr   = dl_wr && dl_ch_rng;
// NOTE the core's crossed wiring (upstream quirk): the dpram INIT'd from
// rom_gfx1_1.hex is written by dl range "01", and the rom_gfx1_2.hex one
// by "00". So blob plane 1 (gfx1_1) must go to core range "01" - selector
// is dl_bg1_rng, NOT dl_bg2_rng. Getting this backwards made CARD-loaded
// games show the old swapped bg colors while baked boots were correct
// (exactly the first v2-card session's report).
wire [15:0] core_dl_addr = {1'b0, dl_bg1_rng, dl_addr[13:0]};

// ------------------------------------------------------------------------
// Sprite SDRAM (Tang module, J9): read port to the core + write port from the
// SD loader. sdram_gw is the MiSTer MCR-3 controller (verified by the memtest
// at 100 MHz); here it runs at clk_sdram = 80 MHz = 2x the 40 MHz core.
// ------------------------------------------------------------------------
wire [14:0] core_sp_addr;   // core -> SDRAM: 15-bit sprite word address
wire [31:0] sp_q;           // SDRAM -> core: 32-bit (4-plane) sprite word

// The loader streams the 128 KB sprite blob as dl_addr[16:0]/dl_data on
// clk_sys. Route it to SDRAM *port2* with MiSTer's exact sprite write-swizzle
// (Arcade-MCR3.sv). port2 is REQUIRED (not port1): the sp read port lives in
// the controller's bank 2,3 group, and only port2 writes into that same group
// - a port1 write lands in banks 0,1 and the sprite read never sees it (the
// "solid white boxes" symptom). The swizzle merges the 8 concatenated planes
// into 32-bit words so a linear sp_addr read returns the 4 planes per column:
//   port2_a  = {7'b0, dl_addr[14:0], dl_addr[16]}   (16-bit word address)
//   port2_ds = {dl_addr[15], ~dl_addr[15]}          (which byte of the word)
//   port2_d  = {dl_data, dl_data}                   (ds picks the lane)
// All three are taken from the SAME pipeline stage (_s2) - see the dl_data_s1/s2
// declaration for why mixing depths silently shifts the whole array by a byte.
// clk_sdram = 2x clk_sys (synchronous), so dl_wr is a 2-cycle pulse here;
// rising-edge detect turns each into exactly one port2 write. The SD byte rate
// is << clk_sdram, so a write always finishes before the next dl_wr.
wire        p1_ack;
wire [23:0] dbg_refresh;    // DIAGNOSTIC: AUTO_REFRESH issue counter (24b, see sdram_gw)
wire [15:0] dbg_blk0, dbg_blk1; // DIAGNOSTIC: refresh-demand blocker counters
// DIAGNOSTIC: refresh RATE over a fixed 2^23-cycle window (~104.9 ms @80MHz).
// A free-running counter sampled by the beacon aliases hopelessly at 133k/s:
// dividing it by 256 did not change the observed rate, which proves the
// sampling - not the signal - set that number. A per-window latched count
// cannot wrap. Healthy = 133333*0.1049 = ~13976 (0x3698);
// starved-at-2325/s would be ~244 (0x00F4). Read in beacon slot E1.
reg [22:0] rw_div = 23'd0;
reg [15:0] rw_cnt = 16'd0, rw_lat = 16'd0;
reg        rw_d   = 1'b0;
always @(posedge clk_sdram) begin
    rw_div <= rw_div + 1'b1;
    rw_d   <= dbg_refresh[0];            // bit0 toggles once per AUTO_REFRESH
    if (dbg_refresh[0] != rw_d) rw_cnt <= rw_cnt + 1'b1;
    if (&rw_div) begin rw_lat <= rw_cnt; rw_cnt <= 16'd0; end
end

reg         sdram_rst_s1 = 1'b1, sdram_rst = 1'b1;
always @(posedge clk_sdram) begin
    sdram_rst_s1 <= core_reset_raw;
    sdram_rst    <= sdram_rst_s1;
end

// ---------------------------------------------------------------------------
// CSD 68000 ROM -> SDRAM banks 0/1 (port1 write, cpu2 read)
// ---------------------------------------------------------------------------
// MCR3Scroll's Cheap Squeak Deluxe board (Spy Hunter, Turbo Tag) has a 32 KB
// 16-bit 68000 ROM. In BSRAM that is 16 blocks, which this build does not
// have; upstream MiSTer keeps it in SDRAM on the cpu2 port and so do we. The
// port1 group (banks 0,1) is otherwise completely idle here - the main CPU and
// sound ROMs are BSRAM - so there is no contention with the sprite read, which
// lives in the banks 2,3 group behind port2/sp.
//
// Byte-lane mapping matches MiSTer's 16-bit swizzle
// (`{ioctl_addr[15], ioctl_addr[13:0], ioctl_addr[14]}`): the download's first
// 16 KB is the LOW byte of each word and the second 16 KB the HIGH byte, i.e.
// the two ROM pairs (u17/u18 then u7/u8) are ROM_LOAD16_BYTE halves.
//   word  = off[13:0]                 (0..0x3FFF, matching csd_rom_addr[14:1])
//   lane  = off[14]                   -> ds = {off[14], ~off[14]}
// Same pipeline-depth rule as the sprite write below: address, data and range
// all come from the _s2 stage. Taking data live off dl_data while the address
// is 2 deep is exactly the bug that stored the sprite array shifted by a byte.
reg        dl_csd_rng_s1 = 1'b0, dl_csd_rng_s2 = 1'b0;
reg [14:0] dl_csd_off_s1 = 15'd0, dl_csd_off_s2 = 15'd0;
reg        pc_req_r = 1'b0, pc_we_r = 1'b0;
reg [23:1] pc_a_r   = 23'd0;
reg [1:0]  pc_ds_r  = 2'b00;
reg [15:0] pc_d_r   = 16'd0;
reg [23:0] csdw_count = 24'd0;   // CSD bytes written to SDRAM (beacon canary)
// Declared HERE, above the sdram_gw instance that uses them: Gowin turns a
// use-before-declaration into a silent 1-bit wire with only a warning, which
// has cost this project a day four separate times.
wire [14:1] csd_rom_addr;        // from mcr3scroll (word address)
wire [15:0] csd_rom_do;          // = cpu2_q
wire [23:1] csd_sdram_addr = !ldr_done ? 23'h7FFFFF : {9'd0, csd_rom_addr[14:1]};
// Sound ROM in SDRAM (SND_IN_SDRAM): 16 KB at BYTE 0x8000, i.e. word 0x4000,
// immediately above the 32 KB CSD region. Read on the idle cpu3 port; written
// through port1 alongside the CSD ROM. Both are in the banks 0,1 group, which
// nothing else in this design touches.
wire [13:0] snd_addr_w;          // from the running core (declared early: Gowin
wire [15:0] snd_sdram_q;         //  makes a use-before-declaration a 1-bit wire)
wire [23:1] snd_sdram_addr = !ldr_done ? 23'h7FFFFF
                                       : (23'h004000 + {10'd0, snd_addr_w[13:1]});
reg        dl_snd_rng_s1 = 1'b0, dl_snd_rng_s2 = 1'b0;
reg [13:0] dl_snd_off_s1 = 14'd0, dl_snd_off_s2 = 14'd0;

reg        dl_wr_s1 = 1'b0, dl_wr_s2 = 1'b0;
reg        dl_sp_rng_s1 = 1'b0, dl_sp_rng_s2 = 1'b0;
reg [16:0] dl_sp_off_s1 = 17'd0, dl_sp_off_s2 = 17'd0;
// dl_data MUST travel the same number of pipeline stages as dl_sp_off/dl_sp_rng.
// It did not between 500c74a and this commit: the address came from the 2-deep
// _s2 registers while the data was taken LIVE off dl_data, so the write landed
// byte j's data at byte j-1's address - the whole 128 KB sprite array stored as
// mem[i] = blob[i+1]. That is exactly the "detached handle / 8px sliver one slot
// right" artifact, and it was present on EVERY load of every post-500c74a build
// (measured: the audit's i%4 bucket counts read the blob prediction rotated by
// one, bit-exact, on 13/13 loads). Keep all three at depth 2.
reg [7:0]  dl_data_s1 = 8'd0, dl_data_s2 = 8'd0;
reg        ldrp_s1 = 1'b0, ldrp_s2 = 1'b0;  // ldr_done sync for the pattern writer
reg [4:0]  pat_step = 5'd31;                // 31 = idle, 0..15 = write steps
reg [4:0]  pat_wait = 5'd0;
reg        p1_req_r = 1'b0, p1_we_r = 1'b0;
reg [14:0] scrub_tick = 15'd0;   // 2^15 @80MHz = 410us per scrub read
reg [6:0]  scrub_row  = 7'd0;    // 128 rows cover the whole 128KB
// SPRITE-WORD AUDIT (2026-07-26): after each load, read back all 32K sprite
// words via the idle port2 and count NONZERO words bucketed by i%4, reported
// in beacon slots E0..E3. This is the per-boot canary for the whole SD ->
// SDRAM sprite path, and it is what caught the byte-alignment bug: a bucket
// tuple that is the blob prediction ROTATED means the array is stored shifted
// (rotate left by one = mem[i] = blob[i+1]); the un-rotated tuple means the
// 128 KB landed byte-exact. Predictions come from the ROM (repo root):
//   python3 -c "import sys;sys.path.insert(0,'tools');from merge_roms import collect
//   g=collect('tapper')['gfx2'];Q=[g[p*0x8000:(p+1)*0x8000] for p in range(4)]
//   c=[0]*4
//   for i in range(0x8000):
//       if Q[3][i]|Q[2][i]|Q[1][i]|Q[0][i]: c[i%4]+=1
//   print([hex(x) for x in c])"
// Expected tuples (pad gfx2 to 0x20000 with zeros first - DoT's is only 64 KB):
//   tapper  {0x1266, 0x1B00, 0x1AD1, 0x13E4}
//   timber  {0x0E74, 0x1786, 0x17FD, 0x0FE1}
//   dotron  {0x07B3, 0x11F3, 0x126A, 0x08AD}
// (Measured before the fix: {0x1B0A, 0x1AD8, 0x1409, 0x128A} = that tuple
// rotated, i.e. the shifted array, on 13/13 loads.)
reg [2:0]  aud_st   = 3'd0;
reg [14:0] aud_i    = 15'd0;
reg [15:0] aud_cnt [0:3];
reg [15:0] aud_lat [0:3];
reg [7:0]  aud_wait = 8'd0;
reg        aud_done = 1'b0;
wire [31:0] p2_q_aud;          // port2 read data (declared before use)
reg [23:1] p1_a_r = 23'd0;
reg [1:0]  p1_ds_r = 2'b00;
reg [15:0] p1_d_r = 16'd0;
// DIAGNOSTIC (temporary): count sprite writes issued + flag if sp_q ever reads
// something other than all-ones. Surfaced in the beacon to localize the
// still-white-boxes fault (write not issued? not landing? read stuck?).
reg [23:0] spw_count = 24'd0;
reg        spq_nonff = 1'b0;
always @(posedge clk_sdram) begin
    dl_wr_s1 <= dl_wr;
    dl_wr_s2 <= dl_wr_s1;
    dl_sp_rng_s1 <= dl_sp_rng;   dl_sp_rng_s2 <= dl_sp_rng_s1;
    dl_sp_off_s1 <= dl_sp_off;   dl_sp_off_s2 <= dl_sp_off_s1;
    dl_data_s1   <= dl_data;     dl_data_s2   <= dl_data_s1;
    dl_csd_rng_s1 <= dl_csd_rng; dl_csd_rng_s2 <= dl_csd_rng_s1;
    dl_csd_off_s1 <= dl_csd_off; dl_csd_off_s2 <= dl_csd_off_s1;
    dl_snd_rng_s1 <= dl_snd_rng && (SND_IN_SDRAM != 0);
    dl_snd_rng_s2 <= dl_snd_rng_s1;
    dl_snd_off_s1 <= dl_addr[13:0]; dl_snd_off_s2 <= dl_snd_off_s1;
    // SCRUB REFRESH (2026-07-24): both AUTO_REFRESH and RAS-only refresh are
    // ineffective on this module (measured: data decays in ~30-100s under
    // either, while rows kept alive by READS survive - the fast sweeps were
    // inadvertently scrub-refreshing). So refresh by the proven mechanism:
    // READ one word from each of the sprite data's 128 rows (bank 2,
    // addr[16:10]) in rotation via the idle port2 - one read per ~410us =
    // every row per ~52ms, negligible bandwidth. Gated on ldr_done so the
    // loader owns port2 during loads.
    // LOUD scrub (2026-07-24): one read per 32 cycles (~2.5M/s), rotating
    // the 128 rows every ~13us. Tests - and if it holds, exploits - the
    // measured activity-dependence: quiet bus -> reads go all-FF within
    // ~30-100s; busy bus -> data stays alive. (One-word-per-row at 410us
    // was too quiet to help; the continuous fast sweeps were not.)
    scrub_tick <= scrub_tick + 15'd1;
    // sprite-word audit FSM (see decl above): owns p1_* while it runs.
    // req/ack toggle protocol: after flipping req, ack == req means the
    // read committed and port2_q holds this word. Aborts back to idle if
    // a new load starts (the loader owns port2 during loads).
    if (aud_st != 3'd0 && aud_st != 3'd5 && !ldrp_s2)
        aud_st <= 3'd0;
    else case (aud_st)
    3'd0: if (ldrp_s2) begin aud_st <= 3'd1; aud_i <= 0; aud_wait <= 0;
              aud_cnt[0] <= 0; aud_cnt[1] <= 0; aud_cnt[2] <= 0; aud_cnt[3] <= 0;
              aud_done <= 1'b0;
          end
    3'd1: begin aud_wait <= aud_wait + 1'd1;    // ~3us settle after ldr_done
              if (&aud_wait) aud_st <= 3'd2; end
    3'd2: begin
              p1_a_r   <= {7'b0, aud_i, 1'b0};
              p1_we_r  <= 1'b0;
              p1_req_r <= ~p1_req_r;
              aud_st   <= 3'd3;
          end
    3'd3: if (p1_ack == p1_req_r) aud_st <= 3'd4;  // read committed
    3'd4: begin                                    // port2_q = word aud_i
              if (p2_q_aud != 32'd0)
                  aud_cnt[aud_i[1:0]] <= aud_cnt[aud_i[1:0]] + 1'd1;
              if (aud_i == 15'h7FFF) begin
                  // aud_cnt[3] hasn't absorbed this last word yet (NBA), so
                  // fold it into the latch by hand. 0x7FFF has i%4 == 3.
                  aud_lat[0] <= aud_cnt[0]; aud_lat[1] <= aud_cnt[1];
                  aud_lat[2] <= aud_cnt[2];
                  aud_lat[3] <= aud_cnt[3] + ((p2_q_aud != 32'd0) ? 16'd1 : 16'd0);
                  aud_done <= 1'b1;
                  aud_st <= 3'd5;                  // done; hold results
              end else begin aud_i <= aud_i + 1'd1; aud_st <= 3'd2; end
          end
    3'd5: if (!ldrp_s2) aud_st <= 3'd0;            // rearm on next load
    default: aud_st <= 3'd0;
    endcase

    if (1'b0) begin   // scrub retired: refresh works at 225deg
        p1_a_r   <= {7'b0, scrub_row, 9'd0};         // word 0 of each row
        p1_we_r  <= 1'b0;
        p1_req_r <= ~p1_req_r;
        scrub_row <= scrub_row + 7'd1;
    end
    if (dl_wr_s1 && !dl_wr_s2 && dl_sp_rng_s2) begin   // new SPRITE dl byte
        p1_a_r    <= {7'b0, dl_sp_off_s2[14:0], dl_sp_off_s2[16]};
        p1_ds_r   <= {dl_sp_off_s2[15], ~dl_sp_off_s2[15]};
        p1_d_r    <= {dl_data_s2, dl_data_s2};   // SAME pipeline depth as the address

        p1_we_r   <= 1'b1;
        p1_req_r  <= ~p1_req_r;             // launch (toggle req vs ack)
        spw_count <= spw_count + 24'd1;
    end
    // CSD 68000 ROM byte -> port1 (banks 0,1). Separate port from the sprite
    // write above, so the two never collide even though both fire off dl_wr.
    if (dl_wr_s1 && !dl_wr_s2 && dl_csd_rng_s2) begin
        pc_a_r     <= {9'd0, dl_csd_off_s2[13:0]};
        pc_ds_r    <= {dl_csd_off_s2[14], ~dl_csd_off_s2[14]};
        pc_d_r     <= {dl_data_s2, dl_data_s2};
        pc_we_r    <= 1'b1;
        pc_req_r   <= ~pc_req_r;
        csdw_count <= csdw_count + 24'd1;
    end
    // Sound ROM byte -> port1, word 0x4000 + off/2, lane = off[0]. The read
    // side takes the same lane from cpu3_q, so the two agree by construction.
    if (dl_wr_s1 && !dl_wr_s2 && dl_snd_rng_s2) begin
        pc_a_r     <= 23'h004000 + {10'd0, dl_snd_off_s2[13:1]};
        pc_ds_r    <= {dl_snd_off_s2[0], ~dl_snd_off_s2[0]};
        pc_d_r     <= {dl_data_s2, dl_data_s2};
        pc_we_r    <= 1'b1;
        pc_req_r   <= ~pc_req_r;
        csdw_count <= csdw_count + 24'd1;
    end
    // DIAGNOSTIC (temporary): after each load finishes, overwrite the top 4
    // sprite words (0x7FC0-0x7FC3) with a known byte pattern via the same
    // port2 path (16 single-byte writes, one per lane). The repeating dump
    // below watches these cells: correct at first read then rotting = decay
    // (refresh dead); wrong from the start = the write path itself.
    // Expected readback: word k = {C3,C2,C1,C0} + k*04040404 (k = 0..3).
    ldrp_s1 <= ldr_done;
    ldrp_s2 <= ldrp_s1;
    if (1'b0) begin   // v6 pattern writer DISABLED (clobbered 4 real words)
        pat_step <= 5'd0;
        pat_wait <= 5'd0;
    end else if (pat_step != 5'd31) begin
        pat_wait <= pat_wait + 5'd1;
        if (&pat_wait) begin                // one write every 32 cycles
            p1_a_r   <= {7'b0, (15'h7FC0 | {13'd0, pat_step[3:2]}), pat_step[1]};
            p1_ds_r  <= pat_step[0] ? 2'b10 : 2'b01;
            p1_d_r   <= {2{8'hC0 | {4'd0, pat_step[3:0]}}};
            p1_we_r  <= 1'b1;
            p1_req_r <= ~p1_req_r;
            pat_step <= (pat_step == 5'd15) ? 5'd31 : pat_step + 5'd1;
        end
    end
    if (sp_q != 32'hFFFFFFFF) spq_nonff <= 1'b1;
end
// DIAGNOSTIC (temporary): after each completed load, sweep all 32K sprite
// words back through the sp read port with a 64-cycle dwell per address
// (~8x the worst-case read latency, so the value sampled is unquestionably
// settled) and classify each word. Separates bad *storage* (a DQM byte lane
// never written -> a lane counter pegs near 32768) from bad *fetch timing*
// during rendering (all counters ~0 here, yet stripes on screen). Sprites
// render garbage for the ~26 ms the sweep steals the sp address bus.
// Byte lanes: sp_q bytes 0,2 came through DQML; bytes 1,3 through DQMH.
reg        ldrd_s1 = 1'b0, ldrd_s2 = 1'b0;
reg        chk_active = 1'b0, chk_done = 1'b0;
reg [14:0] chk_addr = 15'd0;
reg [5:0]  chk_dwell = 6'd0;
reg [15:0] chk_allff = 16'd0;  // words entirely 0xFFFFFFFF
reg [15:0] chk_loff  = 16'd0;  // words with both DQML lanes 0xFF (not all-FF)
reg [15:0] chk_hoff  = 16'd0;  // words with both DQMH lanes 0xFF (not all-FF)
// PERIODIC sweep (2026-07-24): run right after each load AND every ~27s
// forever. The trajectory of chk_allff answers the remaining question in
// one boot: starts ~51 (perfect image) and GROWS -> something destroys the
// array in operation (e.g. a read that acts as a write); starts at 32768 ->
// the port2 writes never land. Latched per pass; pass_n counts sweeps.
// HALF/FULL experiment (2026-07-24): the array dies within ~26s of a good
// load (allff 16 -> 32768 measured). Suspect: reads destroy. So the engine
// is disconnected again, periodic sweeps read ONLY the lower 16K words, and
// every 4th pass reads the full 32K to check the UNTOUCHED upper half.
//   read-half dies, untouched half lives  -> reads are destructive
//   both halves die                       -> time-based destroyer
reg [21:0] sp_addr_r  = 22'd0;   // registered sp_addr source (timing)
reg [33:0] chk_timer  = 34'd0;  // 107s cadence: separates read-count damage from time damage
reg [15:0] allff_lo_l = 16'hDEAD, allff_hi_l = 16'hDEAD;
reg [15:0] allff_lo   = 16'd0,    allff_hi   = 16'd0;
reg [15:0] partff     = 16'd0;   // words with SOME FF byte but not all
reg [15:0] remis      = 16'd0;   // same-address double-read disagreements
reg [31:0] chk_first  = 32'hBADBAD;
reg        chk_full   = 1'b0;
reg [7:0]  pass_n     = 8'd0;
always @(posedge clk_sdram) begin
    ldrd_s1 <= ldr_done;
    ldrd_s2 <= ldrd_s1;
    sp_addr_r <= chk_active ? {7'd0, chk_addr} : {7'd0, core_sp_addr};
    if (!chk_active) chk_timer <= chk_timer + 34'd1;
    if (1'b0) begin   // sweep RETIRED (needed the sp mux; diagnostics evicted)
        chk_active <= 1'b1;
        chk_full   <= (pass_n[1:0] == 2'd3);   // every 4th pass: full array
        chk_timer  <= 34'd0;
        chk_addr   <= 15'd0;
        chk_dwell  <= 6'd0;
        allff_lo   <= 16'd0;
        allff_hi   <= 16'd0;
        partff     <= 16'd0;
        remis      <= 16'd0;
    end else if (chk_active) begin
        chk_dwell <= chk_dwell + 6'd1;
        if (chk_dwell == 6'd63) begin
            if (sp_q == 32'hFFFFFFFF) begin
                if (chk_addr[14]) allff_hi <= allff_hi + 16'd1;
                else              allff_lo <= allff_lo + 16'd1;
            end
            // decay-vs-transaction discriminators: cell decay makes MANY
            // partially-FF words long before whole words die; transaction
            // failure returns FF for the whole 32-bit word atomically.
            // Double-read: dwell 0-31 = first read, 32-63 = re-read same
            // address; a flickering word (FF once, data once) = transaction.
            else if (sp_q[31:24]==8'hFF || sp_q[23:16]==8'hFF ||
                     sp_q[15:8]==8'hFF  || sp_q[7:0]==8'hFF)
                partff <= partff + 16'd1;
            if (chk_dwell == 6'd31) chk_first <= sp_q;   // snapshot mid-dwell
            if (sp_q != chk_first && chk_dwell == 6'd63 && chk_first != 32'hBADBAD)
                remis <= remis + 16'd1;
            chk_addr <= chk_addr + 15'd1;
            if (chk_addr == (chk_full ? 15'h7FFF : 15'h3FFF)) begin
                chk_active <= 1'b0;
                chk_done   <= 1'b1;
                allff_lo_l <= allff_lo + ((sp_q == 32'hFFFFFFFF && !chk_addr[14]) ? 16'd1 : 16'd0);
                if (chk_full)
                    allff_hi_l <= allff_hi + ((sp_q == 32'hFFFFFFFF && chk_addr[14]) ? 16'd1 : 16'd0);
                pass_n     <= pass_n + 8'd1;
            end
        end
    end
end

// sample the clk_sdram diagnostics into clk_sys for the beacon (synchronous)
reg [23:0] spw_count_s = 0;
reg        spq_nonff_s = 0;
reg [15:0] chk_allff_s = 0, chk_loff_s = 0, chk_hoff_s = 0;
reg        chk_done_s = 0;
reg [23:0] dbg_refresh_s = 0;
reg [15:0] dbg_blk0_s = 0, dbg_blk1_s = 0;
reg [15:0] rw_lat_s = 0;
reg [15:0] boot_dbg_s = 0;   // DIAGNOSTIC: boot-kick evidence, beacon E2
reg        aud_done_s = 0;
reg [15:0] aud_lat_s [0:3];
always @(posedge clk_sys) begin
    aud_done_s   <= aud_done;
    aud_lat_s[0] <= aud_lat[0];  aud_lat_s[1] <= aud_lat[1];
    aud_lat_s[2] <= aud_lat[2];  aud_lat_s[3] <= aud_lat[3];
    spw_count_s <= spw_count;
    spq_nonff_s <= spq_nonff;
    chk_allff_s <= chk_allff;
    chk_loff_s  <= chk_loff;
    chk_hoff_s  <= chk_hoff;
    chk_done_s  <= chk_done;
    dbg_refresh_s <= dbg_refresh;
    dbg_blk0_s <= dbg_blk0;
    dbg_blk1_s <= dbg_blk1;
    rw_lat_s   <= rw_lat;
    boot_dbg_s <= {rr_rises, rst_evts[6:0], boot_kicked};
end

// DIAGNOSTIC (temporary): repeating windowed dump of the sprite SDRAM over
// the UART. Every ~1.7 s it prints a snapshot: a "========" marker line then
// 136 words as 8-hex + LF (~106 ms of TX, beacon muxed away meanwhile):
//   lines   0..63  = sprite words 0x0000-0x003F  (read all-FF in dump #1)
//   lines  64..127 = sprite words 0x2780-0x27BF  (the dump-#1 survivor region)
//   lines 128..135 = sprite words 0x7FC0-0x7FC7  (0x7FC0-3 = the known
//                    pattern the post-load writer plants; expect
//                    C3C2C1C0 C7C6C5C4 CBCAC9C8 CFCECDCC)
// Watching the SAME cells across snapshots separates decay (refresh dead:
// correct -> rot) from a broken write path (wrong from snapshot #1).
localparam DUMP_DIV = 40_000_000 / 115200;   // 347, same baud as the beacon
function [7:0] dump_hex(input [3:0] n);
    dump_hex = (n < 10) ? (8'h30 + n) : (8'h41 + n - 10);
endfunction
reg        dump_active = 1'b0, dump_started = 1'b0;
reg        dump_sampling = 1'b0;
reg        dump_marker = 1'b0;
// EXPERIMENT layout: 20 probe cells x 3 lines each (read1, dummy-address
// read to force a fresh activation, read2 of the same cell ~1.7 ms later).
// Probes 0..15 = 0x2780+j (loaded data), 16..19 = 0x7FC0+k (planted
// pattern). read1 == expected but read2 == FF proves the array holds data
// until it is ACCESSED - a destructive-read / refresh-collision fault, not
// leak decay. Both reads FF from the start = the write path never landed it.
reg [4:0]  dump_j  = 5'd0;      // which probe cell (0..19)
reg [1:0]  dump_ph = 2'd0;      // 0 = read1, 1 = dummy, 2 = read2
reg [23:0] dump_gap = 24'd0;    // ~0.42 s between snapshots
reg [5:0]  dump_wait = 6'd0;
reg [8:0]  dump_baud = 9'd0;
reg [3:0]  dump_bit  = 4'd0;    // 0 = start, 1..8 = data, 9 = stop
reg [3:0]  dump_char = 4'd0;    // 0..7 = hex nibbles MSB-first, 8 = LF
reg [31:0] dump_word = 32'd0;
reg        dump_txd = 1'b1;
wire [14:0] dump_base = (dump_j < 5'd16) ? (15'h2780 + {10'd0, dump_j})
                                         : (15'h7FC0 + {13'd0, dump_j[1:0]});
wire [14:0] dump_a = (dump_ph == 2'd1) ? (15'h0400 + {10'd0, dump_j}) : dump_base;
wire [7:0] dump_cur = (dump_char == 4'd8) ? 8'h0A :
                      dump_marker         ? "="   : dump_hex(dump_word[31:28]);
always @(posedge clk_sys) begin
    if (!dump_active) begin
        dump_txd <= 1'b1;
        dump_gap <= dump_gap + 24'd1;
        // first snapshot right after the load completes, then periodic
        if (1'b0) begin  // v6 dump DISABLED (stole UART + probed sp bus)
            dump_started  <= 1'b1;
            dump_active   <= 1'b1;
            dump_marker   <= 1'b1;      // snapshot starts with a marker line
            dump_sampling <= 1'b0;
            dump_j        <= 5'd0;
            dump_ph       <= 2'd0;
            dump_char     <= 4'd0;
            dump_bit      <= 4'd0;
            dump_baud     <= 9'd0;
        end
    end else if (dump_sampling) begin
        // hold the address for 64 clk_sys cycles (>> read latency), then latch
        dump_txd  <= 1'b1;
        dump_wait <= dump_wait + 6'd1;
        if (dump_wait == 6'd63) begin
            dump_word     <= sp_q;
            dump_sampling <= 1'b0;
            dump_char     <= 4'd0;
            dump_bit      <= 4'd0;
            dump_baud     <= 9'd0;
        end
    end else begin
        if (dump_baud == DUMP_DIV - 1) begin
            dump_baud <= 9'd0;
            if (dump_bit == 4'd9) begin
                dump_bit <= 4'd0;
                if (dump_char == 4'd8) begin        // line finished
                    if (dump_marker) begin
                        dump_marker   <= 1'b0;      // marker done -> first read
                        dump_sampling <= 1'b1;
                        dump_wait     <= 6'd0;
                    end else if (dump_j == 5'd19 && dump_ph == 2'd2) begin
                        dump_active <= 1'b0;        // snapshot done
                        dump_gap    <= 24'd0;
                    end else begin
                        if (dump_ph == 2'd2) begin
                            dump_ph <= 2'd0;
                            dump_j  <= dump_j + 5'd1;
                        end else begin
                            dump_ph <= dump_ph + 2'd1;
                        end
                        dump_sampling <= 1'b1;
                        dump_wait     <= 6'd0;
                    end
                end else begin
                    dump_char <= dump_char + 4'd1;
                    dump_word <= dump_word << 4;
                end
            end else begin
                dump_bit <= dump_bit + 4'd1;
            end
        end else begin
            dump_baud <= dump_baud + 9'd1;
        end
        case (dump_bit)
            4'd0:    dump_txd <= 1'b0;
            4'd9:    dump_txd <= 1'b1;
            default: dump_txd <= dump_cur[dump_bit - 4'd1];
        endcase
    end
end

// Plain AUTO_REFRESH: refresh was NEVER the problem - the 0-deg pin clock
// was (proven 2026-07-24: pure-upstream sdram_gw + 225deg = 0 errors).
sdram_gw #(.RFRSH_CYCLES(10'd600)) sdram (
    .SDRAM_DQ(O_sdram_dq_io),
    .SDRAM_A(O_sdram_addr),
    .SDRAM_DQML(O_sdram_dqm[0]),
    .SDRAM_DQMH(O_sdram_dqm[1]),
    .SDRAM_BA(O_sdram_ba),
    .SDRAM_nCS(O_sdram_cs_n),
    .SDRAM_nWE(O_sdram_wen_n),
    .SDRAM_nRAS(O_sdram_ras_n),
    .SDRAM_nCAS(O_sdram_cas_n),
    .SDRAM_CKE(),                 // no board pin; module ties CKE high
    .SDRAM_CLK(O_sdram_clk),
    .init_n(~sdram_rst),
    .clk(clk_sdram), .clk_fwd(clk_sdram_ph),
    // port1 (banks 0,1): the CSD 68000 ROM download write. Deliberately a
    // different bank group from the sprite read, so it cannot steal cycles
    // from rendering.
    .port1_req(pc_req_r), .port1_ack(), .port1_we(pc_we_r),
    .port1_a(pc_a_r), .port1_ds(pc_ds_r), .port1_d(pc_d_r), .port1_q(),
    .cpu1_addr(23'd0), .cpu1_q(),
    // cpu2: the CSD 68000's instruction/data fetch, word-addressed. Parked at
    // all-ones while a load runs (MiSTer does the same) so a fetch cannot race
    // the write stream.
    .cpu2_addr(csd_sdram_addr), .cpu2_q(csd_rom_do),
    // cpu3: the SSIO sound Z80's ROM fetch (SND_IN_SDRAM). Tied off when the
    // sound ROM stays in BSRAM.
    .cpu3_addr(SND_IN_SDRAM ? snd_sdram_addr : 23'd0), .cpu3_q(snd_sdram_q),
    // port2: sprite download write (shares the sp read's bank 2,3 group)
    .port2_req(p1_req_r), .port2_ack(p1_ack), .port2_we(p1_we_r),
    .port2_a(p1_a_r), .port2_ds(p1_ds_r), .port2_d(p1_d_r), .port2_q(p2_q_aud),
    // sprite read to the core: 15-bit word addr -> 32-bit plane word
    // v6 EXPERIMENT REVERTED 2026-07-23: the core drives the sp bus again.
    // (While disconnected, sp_addr followed the dump's probe address and the
    // core rendered from frozen sp_q - white boxes were GUARANTEED, masking
    // whatever the real sprite-path state is.)
    // While a sweep pass runs (~26ms every ~27s) it borrows the bus; the
    // game's sprites glitch for that instant, which is fine for a diag build.
    // HALF/FULL experiment: engine disconnected (parked at 0) - only the
    // sweep touches the array. Mux REGISTERED: combinational chk mux into
    // the controller's addr compare was -0.148ns setup at 80MHz.
    // Sprite address straight from the core, MiSTer-exact: the diagnostic
    // sp_addr_r register added a cycle of fetch latency (a suspect for a
    // slight sprite X offset), and the health sweep that needed the mux is
    // retired with the rest of the bring-up instrumentation.
    .sp_addr({7'd0, core_sp_addr}),
    .sp_q(sp_q),
    // (core_sp_addr is muxed between the MCR-3 and MCR3Scroll cores below -
    // both drive a 15-bit word address into the same 128 KB region, and only
    // one core is out of reset at a time.)
    .dbg_refresh(dbg_refresh),
    .dbg_blk0(dbg_blk0), .dbg_blk1(dbg_blk1)
);

wire [15:0] rom_addr;
wire [7:0]  rom_do;
wire [13:0] snd_addr;
wire [7:0]  snd_do;

// bg WRITE address must be family-aware. The shared RAMs are 16 KB (MCR-3's
// size); MCR-2's planes are 8 KB and its bg2 region starts at 0x1E000, whose
// dl_addr[13:0] is 0x2000 - so slicing 14 bits put MCR-2's second plane 8 KB
// too high while the core read the bottom, leaving plane 2 BLANK (wrong
// colours, and garbage where the background should be empty). MCR-3's bg2 is
// at 0x18000 where [13:0] is 0, which is why it never showed there.
// The stream checksums could not catch this: they measure what the loader
// DELIVERS, not where it LANDS - the same blindness as the sprite bug.
wire [13:0] bg_wr_addr = ldr_is_mcr1 ? {2'b00, dl_addr[11:0]} :
                         ldr_is_mcr2 ? {1'b0,  dl_addr[12:0]} : dl_addr[13:0];

// ===========================================================================
// STORED-ROM AUDIT (post-load read-back)
// ---------------------------------------------------------------------------
// The download-stream checksums this replaces measured what the loader
// DELIVERED. Three separate bugs this project has hit - the sprite one-word
// shift, MCR-2's bg plane 2 landing 8 KB high, and Timber's colours - were all
// "delivered correctly, STORED wrongly", and the stream checksums matched
// throughout every one of them. This sweeps what actually LANDED.
//
// Uses each RAM's port B, which is the download port and is idle once the load
// finishes, so the core's port A is untouched. ~112K reads at 40 MHz = ~3 ms.
// Compare against tools/ckstore.py.
// ---------------------------------------------------------------------------
reg  [15:0] ck_cpu = 16'd0, ck_snd = 16'd0, ck_bg1 = 16'd0, ck_bg2 = 16'd0;
reg  [1:0]  sr_st  = 2'd0;
reg  [16:0] sr_i   = 17'd0;
reg         sr_run = 1'b0;
reg         sr_q1 = 1'b0, sr_q2 = 1'b0;
wire [15:0] q_cpu, q_snd, q_bg1, q_bg2;
// Port-B address: the loader owns it during a load, the audit afterwards.
wire [15:0] pb_cpu = sr_run ? sr_i[15:0] : dl_addr[15:0];
wire [13:0] pb_snd = sr_run ? sr_i[13:0] : dl_addr[13:0];
wire [13:0] pb_bg  = sr_run ? sr_i[13:0] : bg_wr_addr;

function [15:0] rox(input [15:0] v, input [7:0] d);
    rox = {v[14:0], v[15]} ^ {8'd0, d};
endfunction

always @(posedge clk_sys) begin
    sr_q1 <= ldr_done; sr_q2 <= sr_q1;
    if (!sr_q2) begin                       // re-arm for every load
        sr_st <= 2'd0; sr_run <= 1'b0;
    end else case (sr_st)
    2'd0: begin                             // CPU ROM, 64K
        sr_run <= 1'b1; sr_i <= 17'd0;
        ck_cpu <= 16'd0; ck_snd <= 16'd0; ck_bg1 <= 16'd0; ck_bg2 <= 16'd0;
        sr_st <= 2'd1;
    end
    // q_b lags addr_b by one cycle, so at step k the data on the bus is for
    // address k-1. Skip the accumulate at k=0 (that sample is stale from the
    // load) and run one step PAST the last address, or the final byte is
    // never folded in - which showed up as every checksum being the true
    // value rotated right once, because that last byte is ROM padding (0).
    2'd1: begin                             // CPU ROM, 64K
        if (sr_i != 17'd0) ck_cpu <= rox(ck_cpu, q_cpu[7:0]);
        if (sr_i == 17'h10000) begin sr_i <= 17'd0; sr_st <= 2'd2; end
        else sr_i <= sr_i + 1'd1;
    end
    2'd2: begin                             // sound 16K + both bg planes 16K
        if (sr_i != 17'd0) begin
            ck_snd <= rox(ck_snd, q_snd[7:0]);
            ck_bg1 <= rox(ck_bg1, q_bg1[7:0]);
            ck_bg2 <= rox(ck_bg2, q_bg2[7:0]);
        end
        if (sr_i == 17'h04000) begin sr_run <= 1'b0; sr_st <= 2'd3; end
        else sr_i <= sr_i + 1'd1;
    end
    default: ;                              // done; hold the results
    endcase
end

dpram #(
    .dWidth(8),
    .aWidth(16),
    // NO BAKE (licensing): a distributed bitstream must not contain ROM data,
    // so this starts blank and the SD pack is the only source. LOADABLE keeps
    // port B writable - without it the empty INIT_FILE would select dpram's
    // read-only-port-B mode and silently kill the download.
    .LOADABLE(1)
) rom_cpu_inst (
    .clk_a(clk_sys),
    .we_a(1'b0),
    .addr_a(rom_addr),
    .d_a(8'h00),
    .q_a(rom_do),

    .clk_b(clk_sys),
    .we_b(cpu_rom_we),
    .addr_b(pb_cpu),
    .d_b(dl_data),
    .q_b(q_cpu)   // download port during a load; audit read-back after
);

// Sound ROM: 16 KB, either its own BSRAM (8 blocks) or SDRAM. See
// SND_IN_SDRAM at the top of the file for why SDRAM is safe here and was not
// for the main CPU.
generate
if (SND_IN_SDRAM == 0) begin: snd_bsram
    dpram #(
        .dWidth(8),
        .aWidth(14),
        .LOADABLE(1)      // NO BAKE (licensing) - see rom_cpu_inst above
    ) rom_snd_inst (
        .clk_a(clk_sys),
        .we_a(1'b0),
        .addr_a(snd_addr),
        .d_a(8'h00),
        .q_a(snd_do),

        .clk_b(clk_sys),
        .we_b(snd_rom_we),
        .addr_b(pb_snd),
        .d_b(dl_data),
        .q_b(q_snd)
    );
end else begin: snd_sdram
    // Byte lane straight off the 16-bit word; the download wrote even bytes to
    // DQML, so snd_addr[0]==0 reads the low byte.
    assign snd_do = snd_addr[0] ? snd_sdram_q[15:8] : snd_sdram_q[7:0];
    assign q_snd  = 16'd0;      // no port B to audit - E4 reads 0 by design
end
endgenerate
assign snd_addr_w = snd_addr;

// --- USB HID host (gamepad on USB-A port 1) -----------------------------------
// nand2mario usb_hid_host: low-speed USB, standard HID pads (DInput). The
// board provides the 15k host pulldowns and 5V VBUS. Runs at 12 MHz.
//
// Reset policy - learned from the flash-boot regression: a JTAG load starts
// the design on a board that has been powered for minutes (pad enumerated,
// idle), but an SPI-flash boot starts it right after configuration, while
// the pad's own MCU is still booting. The original 21 us reset ran
// enumeration once into a not-yet-ready pad; the engine then sticks in a
// state it cannot leave on its own - CONFIRMED on hardware: even
// unplug/replug does not revive it, only reset does. So recovery must come
// from out here, and it must not rely on the engine's conerr flag alone
// (the stuck state may never raise it):
//   - hold the host in reset ~350 ms at power-on (slow pads);
//   - whenever NO device is enumerated (typ == 0) or conerr is up,
//     continuously for ~2.8 s, pulse reset and re-enumerate.
// With no pad plugged this is a harmless slow retry loop; late-booting and
// hot-plugged pads get picked up on the next cycle.
reg [22:0] usb_rst_cnt = 23'd0;
reg [24:0] usb_idle_cnt = 25'd0;
wire usb_resetn = usb_rst_cnt[22];        // 2^22 / 12 MHz = 350 ms
wire usb_conerr;
wire [1:0] usb_typ;
always @(posedge clk_usb) begin
    if (!usb_resetn)
        usb_rst_cnt <= usb_rst_cnt + 23'd1;
    if (!usb_resetn || (usb_typ != 2'd0 && !usb_conerr))
        usb_idle_cnt <= 25'd0;
    else begin
        usb_idle_cnt <= usb_idle_cnt + 25'd1;
        if (&usb_idle_cnt) usb_rst_cnt <= 23'd0;  // ~2.8 s dead: re-init
    end
end

wire pad_l, pad_r, pad_u, pad_d;
wire pad_a, pad_b, pad_x, pad_y, pad_sel, pad_sta;

usb_hid_host usb1 (
    .usbclk(clk_usb),
    .usbrst_n(usb_resetn),
    .usb_dm(usb1_dn),
    .usb_dp(usb1_dp),
    .typ(usb_typ),
    .report(),
    .conerr(usb_conerr),
    .key_modifiers(), .key1(), .key2(), .key3(), .key4(),
    .mouse_btn(), .mouse_dx(), .mouse_dy(),
    .game_l(pad_l), .game_r(pad_r), .game_u(pad_u), .game_d(pad_d),
    .game_a(pad_a), .game_b(pad_b), .game_x(pad_x), .game_y(pad_y),
    .game_sel(pad_sel), .game_sta(pad_sta),
    .dbg_hid_report()
);

// Synchronize the (active-high, 12 MHz-domain) pad bits into clk_sys
reg [9:0] pad_sync1 = 0, pad_sync2 = 0;
reg [1:0] usb_typ_s1 = 0, usb_typ_s2 = 0;   // quasi-static, for the beacon
always @(posedge clk_sys) begin
    pad_sync1 <= {pad_l, pad_r, pad_u, pad_d, pad_a, pad_b, pad_x, pad_y, pad_sel, pad_sta};
    pad_sync2 <= pad_sync1;
    usb_typ_s1 <= usb_typ;
    usb_typ_s2 <= usb_typ_s1;
end
wire u_left  = pad_sync2[9], u_right = pad_sync2[8];
wire u_up    = pad_sync2[7], u_down  = pad_sync2[6];
wire u_btn_a = pad_sync2[5], u_btn_b = pad_sync2[4];
wire u_btn_x = pad_sync2[3], u_btn_y = pad_sync2[2];
wire u_sel   = pad_sync2[1], u_sta   = pad_sync2[0];

// Core video signals, declared ahead of everything that references them
wire [2:0] r, g, b;
wire       hblank, vblank;
wire       hs, vs, cs;

// --- Core Controls & Switch Mapping (Tapper) -----------------------------
// MCR-3 Tapper: 2-player, each a 4-way stick + a "pour/serve" button.
// SSIO ports (real board numbering): IP0 = coins/starts/button/tilt/service/
// test (J4 1-8), IP1 = P1 stick (J4 D0-7), IP2 = P2 stick + pour. Pad: dpad
// = P1 stick, A = pour, Start = Start1, Select = Coin1 (board key 2 also
// coins). P2 is tied off for now (single pad); IP3 DIP + the exact P2 bits
// need a MAME cross-check (attract mode does not need them).
wire m_left    = u_left  & ~u_sel & ~osd_active;
wire m_right   = u_right & ~u_sel & ~osd_active;
wire m_up      = u_up    & ~u_sel & ~osd_active;
wire m_down    = u_down  & ~u_sel & ~osd_active;
wire m_pour    = u_btn_a & ~osd_active;

// Kozmik Kroozr's synthesised analogue stick (recentres on release).
reg  vbl_r = 1'b1;
wire vbl_edge = vblank & ~vbl_r;      // declared before use
always @(posedge clk_sys) vbl_r <= vblank;

reg [7:0] stick_x = 8'h64, stick_y = 8'h64;
always @(posedge clk_sys) begin
    if (vbl_edge) begin
        if      (m_left  && stick_x > 8'h30) stick_x <= stick_x - 8'd4;
        else if (m_right && stick_x < 8'h98) stick_x <= stick_x + 8'd4;
        else if (!m_left && !m_right)        stick_x <= 8'h64;

        if      (m_up    && stick_y > 8'h30) stick_y <= stick_y - 8'd4;
        else if (m_down  && stick_y < 8'h98) stick_y <= stick_y + 8'd4;
        else if (!m_up && !m_down)           stick_y <= 8'h64;
    end
end

// ---- MCR-2 face buttons and analogue controls -----------------------------
// The merged roster carries BOTH families' input maps, so the MCR-2 games'
// signals must exist here too: face buttons, Tron's aim spinner, Wacko's
// trackball pair, Kozmik Kroozr's dial and Two Tigers' dial. Masked exactly
// like the MCR-3 set above so the OSD still swallows every game input.
wire m_a = u_btn_a & ~osd_active;
wire m_b = u_btn_b & ~osd_active;
wire m_x = u_btn_x & ~osd_active;
wire m_y = u_btn_y & ~osd_active;

wire [7:0] spin_tron;
spinner #(.INC_NORMAL(20), .INC_FAST(40), .INC_SPINNER(20)) sp_tron (
    .clk(clk_sys), .reset(core_reset),
    .minus(m_x), .plus(m_y), .fast(1'b0), .strobe(vblank),
    .spin_in(9'd0),    // reserved: USB mouse as a true spinner
    .spin_out(spin_tron)
);

// WACKO trackball: free-running X/Y counters driven by the d-pad
wire [7:0] tb_x, tb_y;
spinner #(.INC_NORMAL(12), .INC_FAST(24), .INC_SPINNER(12)) sp_tb_x (
    .clk(clk_sys), .reset(core_reset),
    .minus(m_left), .plus(m_right), .fast(1'b0), .strobe(vblank),
    .spin_in(9'd0), .spin_out(tb_x)
);
spinner #(.INC_NORMAL(12), .INC_FAST(24), .INC_SPINNER(12)) sp_tb_y (
    .clk(clk_sys), .reset(core_reset),
    .minus(m_up), .plus(m_down), .fast(1'b0), .strobe(vblank),
    .spin_in(9'd0), .spin_out(tb_y)
);

// KOZMIK KROOZR cockpit dial (X/Y)
wire [7:0] dial_kz;
spinner #(.INC_NORMAL(16), .INC_FAST(32), .INC_SPINNER(16)) sp_kz (
    .clk(clk_sys), .reset(core_reset),
    .minus(m_x), .plus(m_y), .fast(1'b0), .strobe(vblank),
    .spin_in(9'd0), .spin_out(dial_kz)
);

// TWO TIGERS player 1 dial (X/Y)
wire [7:0] dial_tt;
spinner #(.INC_NORMAL(20), .INC_FAST(40), .INC_SPINNER(20)) sp_tt (
    .clk(clk_sys), .reset(core_reset),
    .minus(m_x), .plus(m_y), .fast(1'b0), .strobe(vblank),
    .spin_in(9'd0), .spin_out(dial_tt)
);

wire m_start1  = u_sta   & ~osd_active;
wire m_start2  = u_btn_x & ~osd_active;
wire m_btn2    = u_btn_b & ~osd_active;   // Timber chop 2 / DoT deflector
wire m_aimup   = u_btn_y & ~osd_active;   // DoT aim up
wire m_aimdn   = u_btn_x & ~osd_active;   // DoT aim down (start2 unavailable in DoT)
wire m_coin1   = (u_sel & ~osd_active) | key_s2;
// Cabinet-side OSD chord (roadmap item 6): hold the physical coin key
// (AB13 on the bench; the shield's coin-door Service line later) for ~3 s
// to open the game-select menu - identical in every family top. Note: on
// the bench the first 3 s of the hold DO insert a coin (the key doubles as
// Coin 1); the shield build will source this from Service instead, which
// feeds no credits.
reg [26:0] menu_hold_cnt = 27'd0;
wire       menu_hold = (menu_hold_cnt == 27'd120_000_000);   // 3 s @40 MHz
always @(posedge clk_sys) begin
    if (!key_s2)                 menu_hold_cnt <= 27'd0;
    else if (!menu_hold)         menu_hold_cnt <= menu_hold_cnt + 27'd1;
end

wire m_service = 1'b0;

reg [7:0] input_0;
reg [7:0] input_1;
reg [7:0] input_2;
reg [7:0] input_3;
reg [7:0] input_4;

// Discs of Tron aim dial: MAME marks it PORT_REVERSE; the Tron convention
// from the mcr2 top applies (pad X/Y buttons rotate; swap minus/plus if
// aim feels inverted on hardware). IP1[6:0] = dial, bit7 unused (reads 1).
wire [7:0] spin_dot;
spinner #(.INC_NORMAL(20), .INC_FAST(40), .INC_SPINNER(20)) sp_dot (
    .clk(clk_sys), .reset(core_reset),
    .minus(m_aimdn), .plus(m_aimup), .fast(1'b0), .strobe(vblank),
    .spin_in(9'd0),
    .spin_out(spin_dot)
);

// --- MCR3Scroll controls ----------------------------------------------------
// Crater Raider's dial: a spinner, MiSTer's own coefficients (-5, 0, -5).
wire [7:0] spin_crater;
spinner #(.INC_NORMAL(-5), .INC_FAST(0), .INC_SPINNER(-5)) sp_crater (
    .clk(clk_sys), .reset(core_reset),
    .minus(m_left), .plus(m_right), .fast(1'b0), .strobe(vblank),
    .spin_in(9'd0),
    .spin_out(spin_crater)
);
// KICK / KICKMAN: the kicker angle is a 4-bit absolute value, driven from the
// d-pad through a spinner (a USB paddle could later feed spin_in). Ported
// verbatim from mcr1_console60k; sensitivity is still a guess.
wire [7:0] kick_spin;
spinner #(.INC_NORMAL(8), .INC_FAST(16), .INC_SPINNER(4)) sp_kick (
    .clk(clk_sys), .reset(core_reset),
    .minus(m_left), .plus(m_right), .fast(1'b0), .strobe(vblank),
    .spin_in(9'd0), .spin_out(kick_spin)
);
// Spy Hunter / Turbo Tag wheel + pedal. The absolute-position decoder lives in
// the top upstream too (steering_control.vhd), not in the core; output_4 bit 7
// is the SSIO output line that multiplexes wheel vs gas onto IP2.
wire [7:0] ms_out4;
wire [7:0] steer_emu, gas_emu;
steering_control steer_inst (
    .clk(clk_sys), .reset(core_reset), .vsync(vs),
    .gas_plus(m_up), .gas_minus(m_down),
    .steering_plus(m_right), .steering_minus(m_left),
    .steering(steer_emu), .gas(gas_emu)
);

always @(*) begin
    // IP0 is identical across the 91490 games (MAME mcr.cpp):
    //   ~{service,3'b0,start2,start1,1'b0,coin1}
    input_0 = ~{ m_service, 3'b000, m_start2, m_start1, 1'b0, m_coin1 };
    // Idle-high DEFAULTS for the other four ports, set BEFORE the case so
    // every branch is complete and nothing infers a latch. The mcr23 top put
    // `input_4 = 8'hFF` AFTER the endcase instead, which is both a latch-free
    // accident and a bug - it overrode every per-game IP4 (see the note at the
    // end of this block).
    input_1 = 8'hFF;
    input_2 = 8'hFF;
    input_3 = 8'hFF;
    input_4 = 8'hFF;
    // Merged roster input mux. idx 0-2 = MCR-3 games, 3-8 = MCR-2 games,
    // 9-11 = MCR3Scroll. Every family's per-game map lives here, selected by
    // the roster index.
    case (game_id)
    5'd2: begin
        // Discs of Tron (MAME 0.265 mcr.cpp): FIRE is IP0 bit 4!
        input_0 = ~{ m_service, 2'b00, m_pour, m_start2, m_start1, 1'b0, m_coin1 };
        // IP1 = 7-bit aim dial via spinner.sv (aim buttons still work on IP2)
        input_1 = {1'b1, spin_dot[6:0]};
        // IP2: ~{cab(upright=1), btn2, aimUp, aimDown, down, up, right, left}
        input_2 = ~{ 1'b0, m_btn2, m_aimup, m_aimdn, m_down, m_up, m_right, m_left };
        input_3 = 8'hFF;   // coin meters 1, rest unused
    end
    5'd1: begin
        // Timber (MAME 0.265 mcr.cpp INPUT_PORTS timber):
        //   IP1/IP2 = ~{2'b0, btn2, btn1, up, down, left, right} (4-way)
        //   IP3 DIP: 0xFB = upright, coin meters 1, demo sounds ON (bit2=0)
        input_1 = ~{ 2'b00, m_btn2, m_pour, m_up, m_down, m_left, m_right };
        input_2 = ~{ 2'b00, m_btn2, m_pour, m_up, m_down, m_left, m_right };
        input_3 = 8'hFB;
    end
    5'd0: begin
        // Tapper (verified vs MiSTer mod_tapper + MRA):
        //   IP1 = IP2 = ~{3'b0,pour,up,down,left,right}; IP3 = 0xFF
        input_1 = ~{ 3'b000, m_pour, m_up, m_down, m_left, m_right };
        input_2 = ~{ 3'b000, m_pour, m_up, m_down, m_left, m_right };
        input_3 = 8'hFF;
    end

    // SATAN'S HOLLOW: IP0 = standard (no button bit), IP1 = {..., fire,
    // shield, right, left}. Pad: A = fire, B = shield, X = Start2, Y = Coin2.
    5'd3: begin
        input_0 = ~{ 2'b00, 1'b0, 1'b0, m_x, m_start1, m_y, m_coin1 };
        input_1 = ~{ 4'b0000, m_a, m_b, m_right, m_left };
        input_2 = 8'hFF;
        input_3 = 8'hFF;
        input_4 = 8'hFF;
    end

    // TRON: IP0 = standard MCR2 (trigger on bit 4), IP1 = 8-bit aim dial
    // (absolute spinner value, NOT active-low switches), IP2 = P1 8-way
    // joystick, IP3 DIPs = 0x80 (upright, coin meters 2, continues allowed,
    // cocktail-trigger input idle high), IP4 = cocktail dial (unused).
    // Pad: dpad = move, A/B = trigger, X/Y = rotate aim.
    5'd4: begin
        input_0 = ~{ 1'b0, m_service, 1'b0, m_a | m_b, 1'b0, m_start1, 1'b0, m_coin1 };
        input_1 = spin_tron;
        input_2 = ~{ 4'b0000, m_down, m_up, m_right, m_left };
        input_3 = 8'h80;
        input_4 = 8'h00;
    end

    // WACKO: IP1/IP2 = trackball X/Y, IP4 = 4-way aim joystick (active low:
    // bit3 up, bit2 down, bit1 left, bit0 right). The SSIO input mux only
    // swaps in the *cocktail* trackball, so upright play needs no mux.
    // Pad: dpad = trackball, A/B/X/Y = aim stick.
    5'd5: begin
        input_0 = ~{ 1'b0, m_service, 1'b0, 1'b0, 1'b0, m_start1, 1'b0, m_coin1 };
        input_1 = tb_x;
        input_2 = tb_y;
        input_3 = 8'hFF;
        input_4 = ~{ 4'b0000, m_a, m_b, m_x, m_y };
    end

    // KOZMIK KROOZR: IP1 packs the cockpit spinner oddly - the SSIO custom
    // read returns ((dial & 0x80) >> 1) | ((dial & 0x70) >> 4), i.e. bit 6 =
    // dial[7], bits 2:0 = dial[6:4], both ACTIVE HIGH; bit 7 is Button 2
    // (active low), bits 5:3 are cockpit sensors. IP2/IP4 = analogue stick.
    // Pad: dpad = stick, A = fire, B = shield, X = Start2, Y = Coin2.
    5'd6: begin
        input_0 = ~{ 1'b0, m_service, 1'b0, m_a, m_x, m_start1, m_y, m_coin1 };
        input_1 = { ~m_b, dial_kz[7], 3'b000, dial_kz[6:4] };
        input_2 = stick_x;
        input_3 = 8'hFF;
        input_4 = stick_y;
    end

    // TWO TIGERS (Tron-conversion set): IP1 = P1 dial, IP4 = P2 dial, IP2
    // low nibble = fire buttons, IP0 bit 4 = "Dogfight Start" - moved to
    // D-pad Up because Select+Start now opens the OSD. Pad: X/Y spin, A/B fire.
    5'd7: begin
        input_0 = ~{ 1'b0, m_service, 1'b0, m_up, 1'b0, m_start1, 1'b0, m_coin1 };
        input_1 = dial_tt;
        input_2 = ~{ 4'b0000, 2'b00, m_b, m_a };
        input_3 = 8'hFF;
        input_4 = 8'h00;   // player 2 dial
    end

    // DOMINO MAN: IP0 = standard (Place/Strike on bit 4), IP1 = 4-way
    // joystick. IP3 DIPs = 0x3E: Music On, light skin, bits2-5 unused (idle
    // high), Upright (bit6 LOW - 0xFF selects cocktail!), two coin meters.
    // Pad: A/B = Place/Strike, X = Start2, Y = Coin2.
    5'd8: begin
        input_0 = ~{ 1'b0, m_service, 1'b0, m_a | m_b, m_x, m_start1, m_y, m_coin1 };
        input_1 = ~{ 4'b0000, m_down, m_up, m_right, m_left };
        input_2 = 8'hFF;
        input_3 = 8'h3E;
        input_4 = 8'hFF;
    end
    // ---- MCR3Scroll (family 3) --------------------------------------------
    // Maps transcribed from refs/Arcade-MCR3Scroll_MiSTer/Arcade-MCR3Scroll.sv
    // (its mod_crater / mod_spyhnt / mod_turbo blocks). DIP bytes are the MRA
    // `switches default` and still want checking against MAME per game.

    // CRATER RAIDER: landscape cabinet (NOT rotated). Dial on IP1, forward/
    // reverse on IP2. Pad: A = fire, B = shield, Start = Start1, X = Start2,
    // D-pad L/R = dial, Up/Down = forward/reverse.
    5'd9: begin
        input_0 = ~{ m_service, 2'b00, m_a, m_start2, m_start1, 1'b0, m_coin1 };
        input_1 = spin_crater;
        input_2 = ~{ 1'b0, m_b, 1'b0, m_y, m_down, m_up, 2'b00 };
        input_3 = 8'hFF;
    end

    // SPY HUNTER: wheel/pedal on IP2, multiplexed by the SSIO output line
    // output_4[7] (wheel when high, gas when low) exactly as upstream.
    // IP0 bit 4 is the GEAR SHIFT, not a start button - Van/Start is IP1 bit 2.
    5'd10: begin
        input_0 = ~{ m_service, 2'b00, m_y, 2'b00, 1'b0, m_coin1 };
        input_1 = ~{ 3'b000, m_a, m_x, m_start1, m_b, m_down };
        input_2 = ms_out4[7] ? steer_emu : gas_emu;
        input_3 = 8'hFF;
    end

    // TURBO TAG (prototype): same wheel/pedal arrangement, buttons in the
    // opposite order on IP1.
    5'd11: begin
        input_0 = ~{ m_service, 2'b00, m_y, 2'b00, 1'b0, m_coin1 };
        input_1 = ~{ 3'b000, m_start1, m_down, m_x, m_b, m_a };
        input_2 = ms_out4[7] ? steer_emu : gas_emu;
        input_3 = 8'hFF;
    end
    // ---- MCR-1 (family 0) --------------------------------------------------
    // Transcribed from mcr1_console60k_top.sv. IP3 = 0xFF (all game-option
    // DIPs off) as there; needs the same tuning pass MCR-1 has always owed.
    // Roster/pack order is kick(12), solarfox(13), kickman(14).

    // KICK / KICKMAN: spinner on IP1's low nibble, kick button on IP0 bit 4.
    5'd12, 5'd14: begin
        input_0 = ~{ m_service, 2'b00, m_a, m_start2, m_start1, 1'b0, m_coin1 };
        input_1 = ~{ 4'b0000, kick_spin[3:0] };
    end

    // SOLAR FOX: 4-way stick mirrored across both nibbles of IP1 (MiSTer maps
    // it to the P1 and rotated axes alike). Two fire buttons.
    5'd13: begin
        input_0 = ~{ m_service, 2'b00, m_a, m_b, m_b, 1'b0, m_coin1 };
        input_1 = ~{ m_up, m_down, m_left, m_right, m_up, m_down, m_left, m_right };
        input_2 = ~{ 7'b0000000, m_a };
    end
    default: ;   // roster indices beyond the 15 games
    endcase
    // NOTE: the merged mcr23 top has an unconditional `input_4 = 8'hFF;` HERE,
    // after the endcase, which silently overrides every per-game IP4 the case
    // sets - Wacko's aim stick, Kozmik Kroozr's synthesised Y axis and Two
    // Tigers' player-2 dial all read 0xFF on that build. The single-family
    // mcr2_console60k top does not have the line; it came in with the merge.
    // Removed here. (Reported for mcr23_console60k separately.)
end

// --- Core Instantiation ---
// (r/g/b/hblank/vblank/hs/vs/cs are declared just before the controls
// section - they are referenced there, and Gowin turns use-before-
// declaration into an implicit 1-bit net with only a warning.)
wire [15:0] audio_l_val, audio_r_val;

wire [9:0] core_hcnt;
wire [9:0] core_vcnt;
wire       core_halt_n;

// Background tile graphics RAMs, hoisted OUT of mcr3.vhd (2026-07-27) so the
// merged top can share one pair between cores. Same 1-cycle read on the same
// INVERTED clock the core used internally (clock_vidn = ~clock_40) - a pure
// port move, no timing change. The core resolves the upstream bg1/bg2 crossing
// internally, so here bg1 simply holds blob region gfx1_1 and bg2 holds gfx1_2.
wire [13:0] bg_addr;
wire [7:0]  bg1_do, bg2_do;
dpram #(.dWidth(8), .aWidth(14), .LOADABLE(1)) bg1_ram (
    .clk_a(~clk_sys), .we_a(1'b0), .addr_a(bg_addr), .d_a(8'h00), .q_a(bg1_do),
    .clk_b(clk_sys),  .we_b(dl_wr && dl_bg1_rng), .addr_b(pb_bg),
    .d_b(dl_data), .q_b(q_bg1)
);
dpram #(.dWidth(8), .aWidth(14), .LOADABLE(1)) bg2_ram (
    .clk_a(~clk_sys), .we_a(1'b0), .addr_a(bg_addr), .d_a(8'h00), .q_a(bg2_do),
    .clk_b(clk_sys),  .we_b(dl_wr && dl_bg2_rng), .addr_b(pb_bg),
    .d_b(dl_data), .q_b(q_bg2)
);

// SHARED 32 KB sprite ROM for MCR-1 and MCR-2 (see the dl decode above).
// Same discipline as the bg pair: port A on ~clk_sys because both cores read
// it on clock_vidn, port B is the download. Only one of the two cores is out
// of reset, so the single read port is never contended.
wire [14:0] sp12_addr;
wire [7:0]  sp12_do;
dpram #(.dWidth(8), .aWidth(15), .LOADABLE(1)) sp12_ram (
    .clk_a(~clk_sys), .we_a(1'b0), .addr_a(sp12_addr), .d_a(8'h00), .q_a(sp12_do),
    .clk_b(clk_sys),  .we_b(dl_wr && (dl_sp1_rng || dl_sp2_rng)),
    .addr_b(sp_wr_addr), .d_b(dl_data), .q_b()
);

// ===========================================================================
// MERGED CORES. Both are instantiated; the inactive one is held in RESET so it
// cannot drive the shared buses. Everything shared (CPU/sound ROM RAM, bg gfx
// pair, video, audio) is muxed by run_family. MCR-3's sprites come from SDRAM;
// MCR-2 keeps its own 32 KB sprite RAM, so there is nothing to mux there.
// ===========================================================================
wire       m3_reset = core_reset || !run_is_mcr3;
wire       m2_reset = core_reset || !run_is_mcr2;
wire       ms_reset = core_reset || !run_is_scroll;
wire       m1_reset = core_reset || !run_is_mcr1;

wire [2:0]  m3_r, m3_g, m3_b, m2_r, m2_g, m2_b, ms_r, ms_g, ms_b;
// MCR-1 emits 4-bit RGB (the only core that does); the shared video path is
// 3:3:3, so take the high three bits - the same truncation mcr1_console60k uses.
wire [3:0]  m1_r4, m1_g4, m1_b4;
wire        m1_vblank, m1_hblank, m1_hs, m1_vs, m1_cs;
wire [9:0]  m1_hcnt, m1_vcnt;
wire [15:0] m1_al, m1_ar;
wire [14:0] m1_rom_addr15;
wire [13:0] m1_snd_addr;
wire [13:0] m1_bg_addr;
wire [14:0] m1_sp_addr;
wire        m3_vblank, m3_hblank, m3_hs, m3_vs, m3_cs;
wire        m2_vblank, m2_hblank, m2_hs, m2_vs, m2_cs;
wire        ms_vblank, ms_hblank, ms_hs, ms_vs, ms_cs;
wire [9:0]  m3_hcnt, m3_vcnt, m2_hcnt, m2_vcnt, ms_hcnt, ms_vcnt;
wire [15:0] m3_al, m3_ar, m2_al, m2_ar, ms_al, ms_ar;
wire [9:0]  ms_csd_audio;
wire [15:0] m3_rom_addr, m2_rom_addr, ms_rom_addr;
wire [13:0] m3_snd_addr, m2_snd_addr, ms_snd_addr;
wire [13:0] m3_bg_addr, ms_bg_addr;
wire [12:0] m2_bg_addr;
wire [14:0] m3_sp_addr, ms_sp_addr, m2_sp_addr;
wire        ms_halt_n;

// MCR3Scroll mixes its Cheap Squeak Deluxe board into the main audio the same
// way MiSTer's top does: `audio + {csd_audio, 5'd0}`.
wire [15:0] ms_mix_l = ms_al + {ms_csd_audio, 5'd0};
wire [15:0] ms_mix_r = ms_ar + {ms_csd_audio, 5'd0};

assign r           = run_is_mcr3 ? m3_r : run_is_scroll ? ms_r : run_is_mcr1 ? m1_r4[3:1] : m2_r;
assign g           = run_is_mcr3 ? m3_g : run_is_scroll ? ms_g : run_is_mcr1 ? m1_g4[3:1] : m2_g;
assign b           = run_is_mcr3 ? m3_b : run_is_scroll ? ms_b : run_is_mcr1 ? m1_b4[3:1] : m2_b;
assign vblank      = run_is_mcr3 ? m3_vblank : run_is_scroll ? ms_vblank : run_is_mcr1 ? m1_vblank : m2_vblank;
assign hblank      = run_is_mcr3 ? m3_hblank : run_is_scroll ? ms_hblank : run_is_mcr1 ? m1_hblank : m2_hblank;
assign hs          = run_is_mcr3 ? m3_hs     : run_is_scroll ? ms_hs     : run_is_mcr1 ? m1_hs : m2_hs;
assign vs          = run_is_mcr3 ? m3_vs     : run_is_scroll ? ms_vs     : run_is_mcr1 ? m1_vs : m2_vs;
assign cs          = run_is_mcr3 ? m3_cs     : run_is_scroll ? ms_cs     : run_is_mcr1 ? m1_cs : m2_cs;
assign core_hcnt   = run_is_mcr3 ? m3_hcnt   : run_is_scroll ? ms_hcnt   : run_is_mcr1 ? m1_hcnt : m2_hcnt;
assign core_vcnt   = run_is_mcr3 ? m3_vcnt   : run_is_scroll ? ms_vcnt   : run_is_mcr1 ? m1_vcnt : m2_vcnt;
assign audio_l_val = run_is_mcr3 ? m3_al     : run_is_scroll ? ms_mix_l  : run_is_mcr1 ? m1_al : m2_al;
assign audio_r_val = run_is_mcr3 ? m3_ar     : run_is_scroll ? ms_mix_r  : run_is_mcr1 ? m1_ar : m2_ar;
assign rom_addr    = run_is_mcr3 ? m3_rom_addr : run_is_scroll ? ms_rom_addr : run_is_mcr1 ? {1'b0, m1_rom_addr15} : m2_rom_addr;
assign snd_addr    = run_is_mcr3 ? m3_snd_addr : run_is_scroll ? ms_snd_addr : run_is_mcr1 ? m1_snd_addr : m2_snd_addr;
assign bg_addr     = run_is_mcr3 ? m3_bg_addr : run_is_scroll ? ms_bg_addr :
                     run_is_mcr1 ? m1_bg_addr : {1'b0, m2_bg_addr};
// Read port of the shared MCR-1/MCR-2 sprite ROM.
assign sp12_addr   = run_is_mcr1 ? m1_sp_addr : m2_sp_addr;
// One 128 KB sprite region in SDRAM, shared: MCR-3 and MCR3Scroll drive the
// same 15-bit word address and only one of them is out of reset.
assign core_sp_addr = run_is_scroll ? ms_sp_addr : m3_sp_addr;

mcr2 #(
    // Sprite line buffers -> LUT RAM. Each is 256x8, i.e. 2 Kb in an 18 Kb
    // block; the three cores have TEN of them between them, and PnR measured
    // this build at 127/118 BSRAM with them in block RAM. See gen_ram.sv.
    .GFX2_INIT(""), .GFX_LOADABLE(1), .SPRLINE_RAMSTYLE("distributed_ram"),
    .SP_EXTERNAL(1)            // 32 KB sprite ROM shared with MCR-1, in the top
) mcr2_core (
    .clock_40(clk_sys), .reset(m2_reset),
    .video_r(m2_r), .video_g(m2_g), .video_b(m2_b),
    .video_vblank(m2_vblank), .video_hblank(m2_hblank),
    .video_hs(m2_hs), .video_vs(m2_vs), .video_csync(m2_cs),
    .hcnt_out(m2_hcnt), .vcnt_out(m2_vcnt),
    .tv15Khz_mode(tv15khz),
    .separate_audio(1'b0), .audio_out_l(m2_al), .audio_out_r(m2_ar),
    .input_0(input_0), .input_1(input_1), .input_2(input_2),
    .input_3(input_3), .input_4(input_4),
    .cpu_rom_addr(m2_rom_addr), .cpu_rom_do(rom_do),
    .snd_rom_addr(m2_snd_addr), .snd_rom_do(snd_do),
    .bg_addr(m2_bg_addr), .bg1_do(bg1_do), .bg2_do(bg2_do),
    .sp_rom_addr(m2_sp_addr), .sp_rom_do(sp12_do),
    // gated on the family being LOADED - the download runs while run_family
    // still names the previous game
    .dl_addr(dl_addr[16:0]), .dl_wr(dl_wr && ldr_is_mcr2), .dl_data(dl_data),
    .dl_nvram_wr(1'b0), .dl_din(), .dl_nvram(1'b0)
);

mcr3 #(.SPRLINE_RAMSTYLE("distributed_ram")) mcr3_core (
    .clock_40(clk_sys),
    .reset(m3_reset),

    // Video outputs (3-bit RGB, same as MCR-2 - no truncation)
    .video_r(m3_r),
    .video_g(m3_g),
    .video_b(m3_b),
    .video_Vblank(m3_vblank),
    .video_hblank(m3_hblank),
    .video_hs(m3_hs),
    .video_vs(m3_vs),
    .video_csync(m3_cs),
    .video_ce(),
    .video_hflip(1'b0),   // upright, no cocktail flip
    .video_vflip(1'b0),
    .hcntout(m3_hcnt),
    .vcntout(m3_vcnt),
    .cpu_halt_n(core_halt_n),

    .tv15Khz_mode(tv15khz),

    .separate_audio(1'b0), // mono mix
    .audio_out_l(m3_al),
    .audio_out_r(m3_ar),

    .input_0(input_0),
    .input_1(input_1),
    .input_2(input_2),
    .input_3(input_3),
    .input_4(input_4),
    .output_4(),           // SSIO output port (lamps/mux) - unused here
    .mcr2p5(1'b0),         // Tapper is 91490 (not Journey/MCR-2.5)

    // CPU + sound ROM (baked in BRAM below); bg is baked inside mcr3.vhd
    .cpu_rom_addr(m3_rom_addr),
    .cpu_rom_do(rom_do),
    .snd_rom_addr(m3_snd_addr),
    .snd_rom_do(snd_do),

    // Sprite ROM: 128 KB in SDRAM (Phase 1). The core drives a 15-bit word
    // address; sdram_gw returns the 32-bit (4-plane) word.
    .sp_addr(m3_sp_addr),
    .sp_graphx32_do(sp_q),

    // Download bus (16-bit on MCR-3). Held OFF here: CPU/sound/bg are baked;
    // the SD pack feeds sprites straight to SDRAM (see the sprite loader below).
    .bg_addr(m3_bg_addr),
    .bg1_do(bg1_do),
    .bg2_do(bg2_do),

    .dl_addr(core_dl_addr),
    .dl_wr(core_dl_wr),
    .dl_data(dl_data),
    .dl_nvram_wr(1'b0),
    .dl_din(),
    .dl_nvram(1'b0)
);

// ===========================================================================
// MCR3Scroll (family 3): Crater Raider, Spy Hunter, Turbo Tag.
// Shares the CPU/sound ROM RAMs, the bg gfx pair and the 128 KB sprite region
// in SDRAM with MCR-3. Genuinely new here: the 4 KB char/alpha plane (inside
// the core, LOADABLE) and the Cheap Squeak Deluxe 68000 ROM, which lives in
// SDRAM rather than BSRAM (32 KB = 16 blocks this build does not have).
// ===========================================================================
// mod_crater / mod_turbo select the board variant. Roster: 9 = Crater Raider
// (SSIO only, no CSD), 10 = Spy Hunter, 11 = Turbo Tag.
wire ms_mod_crater = run_is_scroll && (game_id == 4'd9);
wire ms_mod_turbo  = run_is_scroll && (game_id == 4'd11);

mcr3scroll #(
    .CH_INIT(""), .GFX_LOADABLE(1), .CSD_ENABLE(SCROLL_CSD),
    .SPRLINE_RAMSTYLE("distributed_ram")
) scroll_core (
    .clock_40(clk_sys), .reset(ms_reset),
    .tv15Khz_mode(tv15khz),
    .video_r(ms_r), .video_g(ms_g), .video_b(ms_b),
    .video_Vblank(ms_vblank), .video_hblank(ms_hblank),
    .video_hs(ms_hs), .video_vs(ms_vs), .video_csync(ms_cs), .video_ce(),
    .hcnt_out(ms_hcnt), .vcnt_out(ms_vcnt), .cpu_halt_n(ms_halt_n),

    .mod_crater(ms_mod_crater), .mod_turbo(ms_mod_turbo),

    .separate_audio(1'b0),
    .audio_out_l(ms_al), .audio_out_r(ms_ar), .csd_audio_out(ms_csd_audio),

    .input_0(input_0), .input_1(input_1), .input_2(input_2),
    .input_3(input_3), .input_4(input_4),
    .output_4(ms_out4),           // SSIO out: bit 7 muxes wheel vs gas on IP2
    .show_lamps(1'b0),

    .cpu_rom_addr(ms_rom_addr), .cpu_rom_do(rom_do),
    .snd_rom_addr(ms_snd_addr), .snd_rom_do(snd_do),
    .csd_rom_addr(csd_rom_addr), .csd_rom_do(csd_rom_do),

    .sp_addr(ms_sp_addr), .sp_graphx32_do(sp_q),
    .bg_addr(ms_bg_addr), .bg1_do(bg1_do), .bg2_do(bg2_do),

    // char/alpha plane only - the bg planes go to the shared RAMs above
    .dl_addr(scroll_dl_addr), .dl_wr(scroll_dl_wr), .dl_data(dl_data),
    .dl_nvram_wr(1'b0), .dl_din(), .dl_nvram(1'b0)
);

// ===========================================================================
// MCR-1 (family 0): Kick, Solar Fox, Kickman.
// Shares everything: the CPU ROM RAM (its program is 32 KB, so it occupies the
// bottom half of the 64 KB), the sound ROM in SDRAM, the bg pair (its planes
// are 4 KB, addressed at the bottom of the 16 KB) and - the reason it fits at
// all - the 32 KB sprite ROM, with MCR-2. Adds only its own scratch RAMs.
// ROT90 cabinet, like Tron and Satan's Hollow.
// ===========================================================================
mcr1 #(
    .GFX1_1_INIT(""), .GFX1_2_INIT(""), .GFX2_INIT(""), .GFX_LOADABLE(1),
    .SP_EXTERNAL(1), .BG_EXTERNAL(1), .SPRLINE_RAMSTYLE("distributed_ram")
) mcr1_core (
    .clock_40(clk_sys), .reset(m1_reset),
    .tv15Khz_mode(tv15khz),
    .video_r(m1_r4), .video_g(m1_g4), .video_b(m1_b4),
    .video_vblank(m1_vblank), .video_hblank(m1_hblank),
    .video_hs(m1_hs), .video_vs(m1_vs), .video_csync(m1_cs), .video_ce(),
    .hcnt_out(m1_hcnt), .vcnt_out(m1_vcnt),

    .separate_audio(1'b0), .audio_out_l(m1_al), .audio_out_r(m1_ar),

    .input_0(input_0), .input_1(input_1), .input_2(input_2),
    .input_3(input_3), .input_4(input_4),

    .cpu_rom_addr(m1_rom_addr15), .cpu_rom_do(rom_do), .cpu_rom_rd(),
    .snd_rom_addr(m1_snd_addr),   .snd_rom_do(snd_do),

    .sp_rom_addr(m1_sp_addr), .sp_rom_do(sp12_do),
    .bg_addr(m1_bg_addr), .bg1_do(bg1_do), .bg2_do(bg2_do),

    .pause(1'b0), .flip(1'b0),    // upright; no cocktail screen flip
    // Everything MCR-1 needs is loaded by the top, so its own dl bus is idle.
    .dl_addr(17'd0), .dl_wr(1'b0), .dl_data(8'h00),
    .dl_nvram_wr(1'b0), .dl_din(), .dl_nvram(1'b0)
);

// --- Pixel timing shared by the analog and HDMI paths ----------------------
// One strobe per core pixel: hcnt advances at the 20 MHz pixel rate (every
// other clk_sys cycle).
reg [9:0] hcnt_r;
always @(posedge clk_sys) hcnt_r <= core_hcnt;
wire pixel_tick = (hcnt_r != core_hcnt);

// Compensation for the core's RGB-vs-hcnt pipeline lag, used by BOTH video
// paths (analog sync alignment below, HDMI capture window further down).
// LIVE TUNING: hold Select and tap D-pad Right (+1) / Left (-1) while
// watching the left edge - garbage/overlap on the LEFT means increase.
// Reported in the UART beacon as "dXX"; hardcode the winner below.
localparam [4:0] CAP_DELAY_DEFAULT = 5'd13;
reg [4:0] cap_delay = CAP_DELAY_DEFAULT;
reg tune_l_r = 0, tune_r_r = 0;
always @(posedge clk_sys) begin
    tune_l_r <= u_sel & u_left;
    tune_r_r <= u_sel & u_right;
    if (u_sel & u_left  & ~tune_l_r & (cap_delay != 5'd0))  cap_delay <= cap_delay - 1'b1;
    if (u_sel & u_right & ~tune_r_r & (cap_delay != 5'd31)) cap_delay <= cap_delay + 1'b1;
end

// --- On-screen display (game-select menu) -----------------------------------
// Composited onto the core's RGB *here*, before the video path splits, so
// the menu shows up identically on HDMI, 31 kHz VGA and native 15 kHz.
// Select+Start toggles it; Up/Down move, A reloads from the SD pack, B
// exits. The core raster STOPS while a reload holds the core in reset, so
// expect ~1 s of frozen HDMI frame / dropped VGA sync during a switch.
wire [8:0] osd_rgb;
osd #(
    .GAME_DEFAULT(5'd0),          // Tapper
    .NUM_GAMES(6'd15),
    // idx 3 shollow + idx 4 tron are ROT90; so are all three MCR3Scroll
    // titles (9 crater, 10 spyhunt, 11 turbotag - vertical cabinets).
    // Crater Raider is a LANDSCAPE cabinet (upstream sets landscape=1), so
    // only Spy Hunter (10) and Turbo Tag (11) join shollow (3) and tron (4).
    // ...and all three MCR-1 titles (12-14) are ROT90 too.
    .ROT_MASK(20'h07C18),
    .TITLE ("    MCR GAME SELECT     "),
    .NAME0 ("   TAPPER               "),
    .NAME1 ("   TIMBER               "),
    .NAME2 ("   DISCS OF TRON        "),
    .NAME3 ("   SATANS HOLLOW        "),
    .NAME4 ("   TRON                 "),
    .NAME5 ("   WACKO                "),
    .NAME6 ("   KOZMIK KROOZR        "),
    .NAME7 ("   TWO TIGERS           "),
    .NAME8 ("   DOMINO MAN           "),
    .NAME9 ("   CRATER RAIDER        "),
    .NAME10("   SPY HUNTER           "),
    .NAME11("   TURBO TAG            "),
    .NAME12("   KICK                 "),
    .NAME13("   SOLAR FOX            "),
    .NAME14("   KICKMAN              ")
) osd_inst (
    .clk(clk_sys),
    .rst(core_reset_raw),
    .pixel_tick(pixel_tick),
    .hcnt(core_hcnt),
    .hblank(hblank),
    .vblank(vblank),
    .mode15(tv15khz),
    .rgb_in({r, g, b}),
    .rgb_out(osd_rgb),
    .btn_up(u_up), .btn_down(u_down),
    .btn_a(u_btn_a), .btn_b(u_btn_b),
    .btn_sel(u_sel), .btn_sta(u_sta), .btn_menu_hold(menu_hold),
    .game_id(game_id),
    .load_slot(osd_idx),
    .loader_restart(osd_restart),
    .loader_done(ldr_done),
    .loader_error(ldr_error),
    .loaded_slot(fam_slot_to_idx(load_family, ldr_slot)),
    .save_req(osd_save),
    .sd_ready(sd_ready),
    .osd_active(osd_active), .osd_nocard(osd_nocard)
);
// Both video paths consume the OSD-composited pixels from here on.
wire [2:0] vid_r = osd_rgb[8:6];
wire [2:0] vid_g = osd_rgb[5:3];
wire [2:0] vid_b = osd_rgb[2:0];

// --- PmodVGA Analog Output (native core timing, zero buffering) ---
// The core's RGB lags its hcnt-derived sync/blank by a fixed pipeline delay
// (tile fetch -> gfx ROM -> palette -> output regs) - the same lag the HDMI
// capture compensates for with cap_delay. Taking hblank/hs raw here let the
// PREVIOUS line's tail leak into the first ~13 visible pixels (a garbled
// strip down the left edge) while blanking swallowed the last 13 real ones.
// Delay the sync/blank signals by the same amount so they line up with the
// pixels they describe. Shares the live-tunable cap_delay: Select + D-pad
// Right/Left adjusts both paths, value shown in the beacon as "dXX".
reg [31:0] hs_sr, vs_sr, cs_sr, hb_sr, vb_sr;
always @(posedge clk_sys) begin
    if (pixel_tick) begin
        hs_sr <= {hs_sr[30:0], hs};
        vs_sr <= {vs_sr[30:0], vs};
        cs_sr <= {cs_sr[30:0], cs};
        hb_sr <= {hb_sr[30:0], hblank};
        vb_sr <= {vb_sr[30:0], vblank};
    end
end
wire [4:0] vga_tap = (cap_delay == 5'd0) ? 5'd0 : cap_delay - 5'd1;
wire hs_d     = (cap_delay == 5'd0) ? hs     : hs_sr[vga_tap];
wire vs_d     = (cap_delay == 5'd0) ? vs     : vs_sr[vga_tap];
wire cs_d     = (cap_delay == 5'd0) ? cs     : cs_sr[vga_tap];
wire hblank_d = (cap_delay == 5'd0) ? hblank : hb_sr[vga_tap];
wire vblank_d = (cap_delay == 5'd0) ? vblank : vb_sr[vga_tap];

// 3:3:3 -> 4:4:4 by MSB replication so full intensity maps to full scale.
// Blank the DAC outside active video so the monitor sees black porches.
wire cab_blank = hblank_d | vblank_d;
assign vga_r = cab_blank ? 4'h0 : {vid_r, vid_r[2]};
assign vga_g = cab_blank ? 4'h0 : {vid_g, vid_g[2]};
assign vga_b = cab_blank ? 4'h0 : {vid_b, vid_b[2]};

// Sync format. 31 kHz always uses separate negative H/V (standard RGBHV).
//
// 15 kHz also defaults to SEPARATE H and V sync, for two reasons: it is what
// a real MCR cabinet expects (the Video connector has discrete H-Sync on
// pin 8 and V-Sync on pin 9), and modern 15 kHz-capable displays detect it
// reliably. Composite sync was the old default and cost a long debug session
// - one LCD silently dropped its entire green channel, apparently deciding a
// csync source must carry sync-on-green and clamping that input. Note such
// displays latch their format detection, so a wrong guess persists until
// sync is disturbed; changing format while running may not re-trigger it.
//
// Strap J10-39 to GND for composite sync on HS instead (RGBS - what an
// OSSC/RetroTink or an SOG-wired monitor may prefer).
// Strap J10-40 to GND to hold VS inactive (pure single-sync RGBS).
wire want_csync = ~map_rows_n;   // J10-39 to GND
wire vsync_off  = ~map_sock_n;   // J10-40 to GND

assign vga_hs = (tv15khz && want_csync) ? cs_d : hs_d;
assign vga_vs = vsync_off ? 1'b1 : vs_d;

// --- PmodVGA plugged directly into the PMOD sockets --------------------------
// Sipeed socket columns (anchored at the power end, which mates with the
// Pmod's VCC/GND columns): [3V3][GND][IO6/7][IO4/5][IO2/3][IO0/1].
// Digilent columns from the same end: [VCC][GND][4/10][3/9][2/8][1/7].
// => forced column pairing: Pmod pins {1,2,3,4} land on even-or-odd IOs
// {0,2,4,6} and pins {7,8,9,10} on the other row - which row is which, and
// which socket meets PmodVGA J1 (R/B) vs J2 (G/sync), depends on physical
// orientation we can't see in the schematic. Both unknowns are runtime
// straps: try the 4 combinations, exactly one shows a stable picture.
wire row_swap  = ~map_rows_n;   // strap to GND to swap rows
wire sock_swap = ~map_sock_n;   // strap to GND to swap sockets

// Socket carrying PmodVGA J1 (R + B ladders)
wire [7:0] j1_rows_a = {vga_b[3], vga_r[3], vga_b[2], vga_r[2],
                        vga_b[1], vga_r[1], vga_b[0], vga_r[0]}; // IO7..IO0
wire [7:0] j1_rows_b = {vga_r[3], vga_b[3], vga_r[2], vga_b[2],
                        vga_r[1], vga_b[1], vga_r[0], vga_b[0]};
wire [7:0] j1_bus = row_swap ? j1_rows_b : j1_rows_a;

// Socket carrying PmodVGA J2 (G ladder + HS/VS; Pmod pins 9/10 are NC)
wire [7:0] j2_rows_a = {1'b0, vga_g[3], 1'b0, vga_g[2],
                        vga_vs, vga_g[1], vga_hs, vga_g[0]};     // IO7..IO0
wire [7:0] j2_rows_b = {vga_g[3], 1'b0, vga_g[2], 1'b0,
                        vga_g[1], vga_vs, vga_g[0], vga_hs};
wire [7:0] j2_bus = row_swap ? j2_rows_b : j2_rows_a;

assign pmod0_io = sock_swap ? j2_bus : j1_bus;
assign pmod1_io = sock_swap ? j1_bus : j2_bus;

// --- HDMI Output: DDR3 framebuffer -> 1280x720@60 (nand2mario/gbatang) ------
// The core streams its native 512x480 image into a DDR3-backed framebuffer,
// which upscales to 720p (game shown 960 wide for 4:3) and drives HDMI with
// audio. This fully decouples core and display timing: no line buffer, no
// genlock, no shimmer. In 15 kHz mode the capture height drops to 240 lines
// per field and the upscaler adapts (integer 3x).

// The core's RGB output lags its hcnt by a fixed pipeline delay (tile fetch ->
// gfx ROM -> palette -> output regs); shift the capture window back by
// cap_delay so each line's pixels land at the right offsets.
// LIVE TUNING: hold Select and tap D-pad Right (+1) / Left (-1) while
// watching the left edge - garbage/overlap on the LEFT means increase.
// The current value is reported in the UART beacon as "dXX" (hex); once the
// sweet spot is found, hardcode it as the reset value below.
// (The D-pad is masked from the game while Select is held; note Select
// itself still inserts a coin - harmless during tuning.)


wire cap_active = !vblank && (core_hcnt >= {5'b0, cap_delay}) && (core_hcnt < {5'b0, cap_delay} + 10'd512);
wire fb_we = pixel_tick && cap_active;
// RGB444: replicate each 3-bit channel's MSB into bit 0 (as the VGA DAC does)
wire [11:0] fb_data = {vid_r, vid_r[2], vid_g, vid_g[2], vid_b, vid_b[2]};

// Single-cycle frame pulse after the last active line (vblank rising edge)
reg fb_vbl_r = 1'b1;
always @(posedge clk_sys) fb_vbl_r <= vblank;
wire fb_vsync = vblank & ~fb_vbl_r;

// DDR3/HDMI bring-up debug on spare J10 pins (probe vs GND with a DMM):
//   debug_o[0] J10-21: init_calib_complete - steady 3.3V = DDR3 trained
//   debug_o[1] J10-22: ~1.1Hz heartbeat from clk_x1 (74.25MHz pixel clock)
//   debug_o[2] J10-23: ~0.8Hz heartbeat from the 27MHz reference
//   debug_o[3] J10-24: ddr_rst - should sit LOW once the DDR PLL settles
wire fb_clk_x1, fb_ddr_rst, fb_calib;
wire fb_hclk;             // HDMI pixel clock (74.25 MHz expected)
// NOTE: do not hang a counter on hclk5 (371 MHz). It is unconstrained in the
// SDC, so the tool cannot see the speed, and the added logic disturbed the
// DDR3 interface enough to stop it calibrating (beacon showed c0). hclk5 was
// measured this way once and confirmed at 5x hclk; that is enough.
reg [24:0] hb_h = 0;
always @(posedge fb_hclk) hb_h <= hb_h + 1'b1;
reg [25:0] hb_x1 = 0;
reg [24:0] hb_27 = 0;
always @(posedge fb_clk_x1) hb_x1 <= hb_x1 + 1'b1;
always @(posedge clk27)     hb_27 <= hb_27 + 1'b1;
assign debug_o = {fb_ddr_rst, hb_27[24], hb_x1[25], fb_calib};

// Same vitals over USB-C serial (BL616 bridges the U15 UART), for debugging
// with the case closed: frozen x____ across lines = pixel clock dead,
// frozen q__ = 27MHz chain dead, c0/r1 = DDR3 never trained.
// DIAGNOSTIC beacon x/q mux: until a sweep has completed, x/q show the
// sprite write counter as before (x ~= 0x0200 per full 128 KB load). Once
// chk_done, x rotates (~0.8 s per phase) through the sweep counters, with q
// tagging which one is showing:
//   qE0: x = core vblank count      (advancing ~60/s = core running)
//   qE1: x = alternating: raw ra_snap (bit15 of a ROM addr < 0xE000 clears
//        only for pages < 0x80... so use the marker) / trail entries
//        {1'b1, idx[2:0], 4'b0, page[7:0]} - last 8 distinct pages visited
//   qE2: x = line wraps per 209.7ms window (healthy 0x19D8 = 31.55kHz)
//   qE3: x = {kick_n[7:0], hwin[21:14]} wedge-watchdog kicks issued this
//        power-on / HALT_n-high cycles per 105ms window (0x00 low byte =
//        CPU continuously halted = crashed; ~0xFF = running)
//        (refresh window retired from the beacon - settled at 132,893/s)
//   qE2: x = boot state {rr_rises[7:0], rst_evts[6:0], boot_kicked}
//        (was dbg_blk1 - proven ~2/s and irrelevant, so the slot was reused)
//   qE3: x = write counter [23:8]   (0x0200 = one clean 128 KB pass)
// DIAGNOSTIC: boot-bug discriminators, packed into beacon slot E1.
// [15:8] m15_flaps - edge count of the SYNCHRONIZED 15kHz strap (tv15khz).
//        tv15Khz_mode selects the vcnt wrap point (263/524) AND the vblank
//        decode window (240/480 lines) in mcr3.vhd, so a fluttering strap
//        makes vblank fire erratically while HS stays ~31kHz - exactly the
//        varying-rate black-boot signature (69.5/80.8/316 Hz measured on
//        three broken boots). Must be FROZEN on a healthy boot. The strap is
//        J10-37, two pins from the PWM audio outputs, weak pull-up only.
// [7:0]  rom_act - main-CPU ROM address activity counter. Racing between
//        beacon samples = the Z80 is fetching; frozen = halted/looping-tight.
// vcnt jump detector: count every vcnt transition that is neither +1 nor a
// legal wrap (524->0 progressive, 263->0 interlaced), and latch the value it
// jumped FROM. In the broken boot vblank fires at 60-316 Hz although vcnt
// has no third writer besides reset - this shows the jumps directly.
reg [9:0]  vcnt_d     = 10'd0;
reg [7:0]  vdisc      = 8'd0;
reg [9:0]  vjump_from = 10'd0;
// hcnt jump detector + line-rate window. vdisc=0 on a BROKEN boot (85.2 Hz
// vblank) proved vcnt counts cleanly - so the extra frames can only come
// from hcnt reaching 633 too often. Watch hcnt the same way, plus count
// line wraps per 2^23-cycle window (~104.9ms): healthy = 31.5k*0.1049 =
// ~3304 (0x0CE8); a 45k line rate reads ~4720.
reg [9:0]  hcnt_dd     = 10'd0;
reg [7:0]  hdisc       = 8'd0;
reg [9:0]  hjump_from  = 10'd0;
reg [9:0]  hjump_to    = 10'd0;
// One-boot simultaneous discriminators (prior boots each measured only one
// signal - never together, so every theory died on a DIFFERENT boot's data):
// vdisc263 counts 263->0 wraps specifically. That wrap is only legal in
// 15kHz mode; with the strap open it must NEVER happen. It was whitelisted
// as "legal" in the vcnt detector - which would have masked exactly this.
// vs_cnt counts video_vs falling edges: if frames wrap early at 263, vs
// (decoded at line 490) is SKIPPED in short frames -> vs rate drops BELOW
// 60 while vblank rises ABOVE it. The split direction identifies the fault.
reg [7:0]  vdisc263   = 8'd0;
reg        vsedge_d   = 1'b1;
reg [15:0] vs_cnt     = 16'd0;
// Z80 fetch-address snapshot, latched ~9.5x/s. The beacon samples slot E1
// every ~3s, so over a minute it collects a scatter of the addresses the
// CPU actually visits. On a black boot that set names the wait loop, which
// MAME's Tapper disassembly can then explain. Plain register capture -
// the earlier 16-bit COMPARE on rom_addr broke core timing; a gated FF
// sink is far lighter.
reg [21:0] snap_div   = 22'd0;
reg [15:0] ra_snap    = 16'd0;
// CPU wedge detect, take 2. Page-change rate was WRONG: a healthy game can
// idle inside one 256-byte page for a whole window, and the first watchdog
// build reset a running Tapper every few seconds (kick_n 13->24 while
// pgrate showed alive - measured). The unambiguous crash signature is the
// T80 sitting in HALT with interrupts dead: HALT_n low with ZERO high
// cycles for an entire ~105ms window. A live game - even one that idles on
// HALT-until-vblank - wakes 60+/s and shows hundreds of high cycles per
// window. No overlap.
reg [21:0] hwin_cnt   = 22'd0;   // HALT_n-high cycles this window
reg [21:0] hwin       = 22'd1;   // latched last window (init nonzero)
// Sprite-path probes (core reconnected to the sp bus 2026-07-23):
//  - spf_cnt/spf_win: core_sp_addr changes per ~105ms window = fetch rate.
//    0 = the engine never fetches; thousands = fetching normally.
//  - q_nz/q_nff: sticky "sp_q was seen nonzero"/"seen non-FFFFFFFF".
//  - spq_snap: latest NONZERO sp_q value (0 forever = data is all zeros).
reg [14:0] spa_d      = 15'd0;
reg [13:0] spf_cnt    = 14'd0, spf_win = 14'd0;
reg        q_nz       = 1'b0, q_nff = 1'b0;
reg [31:0] spq_snap   = 32'd0;
reg [27:0] wd_holdoff = 28'd0;
reg        core_reset_d2 = 1'b1;
// Crash trail: ring of the last 8 distinct 256-byte PAGES the CPU visited.
// When the CPU halts in the AFxx data table, the pages just before AF name
// the routine that crashed - that plus MAME's disassembly identifies what
// it was reading when it went over the cliff. Reported round-robin on E1
// as {1'b1, trail_idx[2:0], 4'b0, page[7:0]} (bit15 set = trail format).
reg [7:0]  trail [0:7];
reg [2:0]  trail_w   = 3'd0;
reg [7:0]  ra_page_d = 8'd0;
reg [2:0]  trail_r   = 3'd0;
reg [22:0] lr_div      = 23'd0;
reg [15:0] lr_cnt      = 16'd0, lr_lat = 16'd0;
reg        m15_d      = 1'b0;
reg [7:0]  m15_flaps  = 8'd0;
// Tap ONE bit of rom_addr, not all 16: the full-width compare loaded the
// Z80's address net enough to break setup on the cpu->video_ram path by
// -0.174ns. Bit 0 toggles on virtually every fetch - same signal, 1/16 load.
reg        rom_a0_d   = 1'b0;
reg [7:0]  rom_act    = 8'd0;
always @(posedge clk_sys) begin
    m15_d <= tv15khz;
    if (tv15khz != m15_d) m15_flaps <= m15_flaps + 8'd1;
    rom_a0_d <= rom_addr[0];
    if (rom_addr[0] != rom_a0_d) rom_act <= rom_act + 8'd1;
    vcnt_d <= core_vcnt;
    if (core_vcnt != vcnt_d
        && core_vcnt != vcnt_d + 10'd1
        && !(core_vcnt == 10'd0 && (vcnt_d == 10'd524 || vcnt_d == 10'd263))) begin
        vdisc      <= vdisc + 8'd1;
        vjump_from <= vcnt_d;
    end
    snap_div <= snap_div + 22'd1;
    if (&snap_div) begin
        ra_snap <= rom_addr;
        trail_r <= trail_r + 3'd1;      // rotate which trail entry E1 shows
    end
    ra_page_d <= rom_addr[15:8];
    if (rom_addr[15:8] != ra_page_d) begin
        trail[trail_w] <= rom_addr[15:8];
        trail_w        <= trail_w + 3'd1;
    end
    if (core_halt_n) hwin_cnt <= hwin_cnt + 22'd1;
    if (&snap_div) begin hwin <= hwin_cnt; hwin_cnt <= 22'd0; end
    spa_d <= core_sp_addr;
    if (core_sp_addr != spa_d && !(&spf_cnt)) spf_cnt <= spf_cnt + 14'd1;
    if (&snap_div) begin spf_win <= spf_cnt; spf_cnt <= 14'd0; end
    if (sp_q != 32'd0)         begin q_nz  <= 1'b1; spq_snap <= sp_q; end
    if (sp_q != 32'hFFFFFFFF)  q_nff <= 1'b1;
    core_reset_d2 <= core_reset;
    if (core_reset) wd_holdoff <= 28'd0;                 // arm on each release
    else if (!(&wd_holdoff)) wd_holdoff <= wd_holdoff + 28'd1;
    if (core_vcnt == 10'd0 && vcnt_d == 10'd263) vdisc263 <= vdisc263 + 8'd1;
    vsedge_d <= vs;
    if (!vs && vsedge_d) vs_cnt <= vs_cnt + 16'd1;   // falling edge = sync start
    hcnt_dd <= core_hcnt;
    if (core_hcnt != hcnt_dd
        && core_hcnt != hcnt_dd + 10'd1
        && !(core_hcnt == 10'd0 && hcnt_dd == 10'd633)) begin
        hdisc      <= hdisc + 8'd1;
        hjump_from <= hcnt_dd;
        hjump_to   <= core_hcnt;
    end
    lr_div <= lr_div + 1'b1;
    if (core_hcnt == 10'd0 && hcnt_dd != 10'd0) lr_cnt <= lr_cnt + 1'b1;
    if (&lr_div) begin lr_lat <= lr_cnt; lr_cnt <= 16'd0; end
end

// fire when: core running, ~6.7s since its release, and the bus is quiet
// Hold-off ~3.4s (2^27 cycles): the halt test cannot false-fire on a live
// or booting game, so there is no reason to wait longer - a crashed cold
// boot retries every ~3.4s+reload until the power-on disturbance has
// passed, and kick_n counts the attempts (= measures the window).
assign wedge_kick = (!core_reset) && (wd_holdoff == 28'd134_217_712)
                    && (hwin == 22'd0);

reg [27:0] diag_cnt = 0;   // 28 bits: diag_ph uses [27:25] (8 slots)
always @(posedge clk_sys) diag_cnt <= diag_cnt + 1'b1;
wire [2:0]  diag_ph = diag_cnt[27:25];   // 8 slots (was 4)

// DIAGNOSTIC: core raster heartbeat. The beacon could not previously tell
// "core halted in reset" apart from "core running, but no picture reaching
// the monitor" - both look like a black screen. This counts vblank rising
// edges in the core's own clock domain, so:
//   advancing ~60/s (+~114 per beacon sample) = the core IS running
//   frozen                                     = the core is halted/reset
// Shown in slot E0, which used to carry dbg_blk0 - that counter is proven
// to be exactly 0 (36/36 samples), so the slot was dead weight.
reg        vbl_d   = 1'b0;
reg [15:0] vbl_cnt = 16'd0;
always @(posedge clk_sys) begin
    vbl_d <= vblank;
    if (vblank && !vbl_d) vbl_cnt <= vbl_cnt + 16'd1;
end
// E1 repurposed: live AUTO_REFRESH issue counter (sweep is disabled).
// A DIFFERENT xE1 value on every beacon line = refresh commands are being
// issued (~133k/s, wraps ~2x/s); frozen x0000 qE1 = the branch never fires.
// SPRITE-WORD AUDIT readout (2026-07-26): once the post-load port2 sweep
// finishes, rotate its four bucket counts through the x field, tagged
// E0..E3 in q. Bucket k = nonzero 32-bit sprite words with i%4 == k
// (k = word-within-sprite-line). E3 ~ 0 with E0-E2 healthy = the 4th words
// never landed. Compare the whole TUPLE against the per-game prediction at
// the audit declaration: matching = byte-exact load; the same four numbers
// ROTATED = the array is stored one word off (that is what the 2026-07-25
// detached-handle artifact was, fixed by aligning dl_data's pipeline depth
// with the address's).
wire [15:0] diag_x = !aud_done_s      ? spw_count_s[23:8] :
                     // E4..E7 = STORED (read-back) checksums, not stream
                     diag_ph == 3'd5 ? ck_cpu :
                     diag_ph == 3'd6 ? ck_bg1 :
                     diag_ph == 3'd7 ? ck_bg2 :
                     diag_ph == 3'd4 ? ck_snd :
                     // TEMPORARY (2026-07-27): the sprite audit has done its
                     // job (bit-exact on every load), so slots E0/E1 now carry
                     // the CORE-LIVENESS counters instead. Timber boot-loads
                     // with every region's checksum correct yet freezes, and a
                     // frozen picture is exactly what a repeatedly-reset core
                     // looks like (hcnt/vcnt sit at 0 under reset, so the DDR3
                     // framebuffer just holds the last frame).
                     //   E0 = {kick_n, hwin[21:14]} - wedge-watchdog kicks
                     //        this power-on, and HALT_n-high cycles/window.
                     //        kick_n CLIMBING = the watchdog is resetting the
                     //        core over and over; that is the freeze.
                     //   E1 = {rr_rises[7:0], rst_evts[6:0], boot_kicked}
                     diag_ph == 3'd0 ? {kick_n, hwin[21:14]} :
                     diag_ph == 3'd1 ? {rr_rises, rst_evts[6:0], boot_kicked} :
                                       aud_lat_s[diag_ph[1:0]];
wire [7:0]  diag_q = !aud_done_s ? spw_count_s[7:0]  :
                                   {5'h1C, diag_ph};   // 8'hE0 | ph

// DIAGNOSTIC: the one-shot SDRAM dump borrows the UART pin while it runs
wire beacon_txd;
assign uart_tx = dump_active ? dump_txd : beacon_txd;

uart_beacon #(.CLK_HZ(40_000_000), .BAUD(115200)) beacon (
    .clk(clk_sys),
    .calib(fb_calib),
    .ddr_rst(fb_ddr_rst),
    // L bit7 = spq_nonff: sp_q was seen != all-ones at least once (=1 means the
    //   sprite read returned real data; =0 means it is stuck all-ones).
    .cnt_x(diag_x),
    .cnt_q(diag_q),
    .aux({game_id[2:0], cap_delay}),   // dXX: high 3 bits = running game_id
    // L bit7 = spq_nonff (sprite read saw non-FF data); rest = SD/loader flags.
    .aux2({spq_nonff_s, hb_h[23], usb_typ_s2, sd_ready, sd_err, ldr_done, ldr_error}),
    .txd(beacon_txd)
);

ddr3_framebuffer #(
    .WIDTH(512),
    .HEIGHT(480),
    .COLOR_BITS(12),
    .PREFETCH_DELAY(44),
    .DVI_MODE(0)          // full HDMI, as NESTang uses (matches the mcr1/mcr2 tops).
                          // Was 1 for the dropout test (strips data islands ->
                          // SILENT). That test is done: the real fix was making
                          // the sample rate and the ACR constants agree at 32 kHz
                          // (see TODO item 1), and the residual is board thermal.
) fb_inst (
    .hclk_dbg(fb_hclk),
    .clk_27(clk27),
    .pll_lock_27(1'b1),
    .clk_g(clk50_pll),        // PLL-buffered 50 MHz (global clock net)
    .clk_out(fb_clk_x1),
    // Reset from the power-on counter ONLY - never from rom_ready. Video must
    // come up independently of ROM loading, otherwise a stalled/slow SD load
    // takes HDMI sync down with it and there is nothing to diagnose from.
    .rst_n(~core_reset_raw),
    .ddr_rst(fb_ddr_rst),
    .init_calib_complete(fb_calib),
    .ddr_prefetch_delay(6'd44),

    // Framebuffer write interface (core pixel stream)
    .clk(clk_sys),
    .fb_width(11'd512),
    .fb_height(tv15khz ? 10'd240 : 10'd480),
    .disp_width(11'd960),     // 4:3 within the 720p canvas
    .fb_vsync(fb_vsync),
    .fb_we(fb_we),
    .fb_data(fb_data),

    // HDMI audio (offset-binary core mix -> signed PCM)
    .sound_left(audio_l_val ^ 16'h8000),
    .sound_right(audio_r_val ^ 16'h8000),

    // DDR3 (on-SOM 4Gb x16)
    .ddr_addr(ddr_addr),
    .ddr_bank(ddr_bank),
    .ddr_cs(ddr_cs),
    .ddr_ras(ddr_ras),
    .ddr_cas(ddr_cas),
    .ddr_we(ddr_we),
    .ddr_ck(ddr_ck),
    .ddr_ck_n(ddr_ck_n),
    .ddr_cke(ddr_cke),
    .ddr_odt(ddr_odt),
    .ddr_reset_n(ddr_reset_n),
    .ddr_dm(ddr_dm),
    .ddr_dq(ddr_dq),
    .ddr_dqs(ddr_dqs),
    .ddr_dqs_n(ddr_dqs_n),

    // HDMI out
    .tmds_clk_n(tmds_clk_n),
    .tmds_clk_p(tmds_clk_p),
    .tmds_d_n(tmds_d_n),
    .tmds_d_p(tmds_d_p)
);

// --- PWM Audio Modulators ---
ds_dac dac_l (
    .clk(clk_sys),
    .resetn(~core_reset),
    .din(audio_l_val),
    .dout(audio_l)
);

ds_dac dac_r (
    .clk(clk_sys),
    .resetn(~core_reset),
    .din(audio_r_val),
    .dout(audio_r)
);

endmodule
